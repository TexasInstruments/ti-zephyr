## CMakeLists.txt
```
# SPDX-FileCopyrightText: 2026 Texas Instruments Incorporated
# SPDX-License-Identifier: LicenseRef-TI-TFL

cmake_minimum_required(VERSION 3.28.0)
find_package(Zephyr REQUIRED HINTS $ENV{ZEPHYR_BASE})
project(realtimelib)

target_sources(app PRIVATE
  src/main.c
  src/test_transforms_pi_filter.c
  src/test_utilities.c
  src/test_filters.c
  src/test_controllers.c
  src/test_datalog.c
  src/test_mtpa.c
  src/test_motorvision.c
  src/test_prebuilt.c
)
```

## prj.conf
```kconfig
CONFIG_ZTEST=y
CONFIG_FPU=y
CONFIG_TI_REALTIMELIB=y
CONFIG_PICOLIBC=y
CONFIG_TI_REALTIMELIB_DATALOG=y
CONFIG_TI_REALTIMELIB_MOTORVISION=y
CONFIG_SERIAL=y
CONFIG_EMUL=y
CONFIG_UART_EMUL=y
CONFIG_TI_REALTIMELIB_FAST=y
CONFIG_TI_REALTIMELIB_FLUX_OBS=y
CONFIG_TI_REALTIMELIB_TI_TUNE=y
CONFIG_TI_REALTIMELIB_DEAD_TIME_COMP=y
```

## app.overlay
```dts
/*
 * Copyright (c) 2026 Texas Instruments Incorporated
 *
 * SPDX-License-Identifier: BSD-3-Clause
 */

/ {
	mv_uart: mv-uart {
		compatible = "zephyr,uart-emul";
		current-speed = <115200>;
		tx-fifo-size = <2048>;
		rx-fifo-size = <64>;
		status = "okay";
	};
};
```

## src/main.c
```c
/*
 * Copyright (c) 2026 Texas Instruments Incorporated
 *
 * SPDX-License-Identifier: BSD-3-Clause
 */

#include <zephyr/ztest.h>

ZTEST_SUITE(realtimelib, NULL, NULL, NULL, NULL, NULL);
```

## src/test_controllers.c
```c
/*
 * Copyright (c) 2026 Texas Instruments Incorporated
 *
 * SPDX-License-Identifier: BSD-3-Clause
 */

#include <math.h>

#include <zephyr/ztest.h>

#include <dclink_ss.h>
#include <fwc.h>
#include <pid.h>
#include <pr.h>
#include <vib_comp.h>
#include <vs_freq.h>

#define TOL 1.0e-4f

/* pid: parallel form, Up = Kp e, Ui += Ki e (clamped), Ud = filtered Kd e */
ZTEST(realtimelib, test_pid_proportional_integral_and_limits)
{
	PID_Obj obj;
	PID_Handle pid = PID_init(&obj, sizeof(obj));
	float out;

	zassert_not_null(pid, "PID_init");
	zassert_is_null(PID_init(&obj, 1), "a too small buffer must be rejected");

	PID_setGains(pid, 2.0f, 0.1f, 0.0f);
	PID_setMinMax(pid, -1.0f, 1.0f);
	PID_setUi(pid, 0.0f);
	/* Derivative filter with zero gain: the derivative path outputs nothing */
	PID_setDerFilterParams(pid, 0.0f, 0.0f, 0.0f, 0.0f, 0.0f);

	/* error = 0.2: Up = 0.4, Ui = 0.02 */
	PID_run_parallel(pid, 0.3f, 0.1f, 0.0f, &out);
	zassert_within(out, 0.42f, TOL, "first run %f", (double)out);
	PID_run_parallel(pid, 0.3f, 0.1f, 0.0f, &out);
	zassert_within(out, 0.44f, TOL, "integrator adds Ki*e each run %f", (double)out);

	/* The feedforward adds to the output */
	PID_setUi(pid, 0.0f);
	PID_run_parallel(pid, 0.0f, 0.0f, 0.25f, &out);
	zassert_within(out, 0.25f, TOL, "feedforward %f", (double)out);

	/* The output and the integrator are limited */
	for (int i = 0; i < 100; i++) {
		PID_run_parallel(pid, 5.0f, 0.0f, 0.0f, &out);
	}
	zassert_within(out, 1.0f, TOL, "upper limit %f", (double)out);
	PID_run_parallel(pid, -5.0f, 0.0f, 0.0f, &out);
	zassert_true(out >= -1.0f - TOL, "never below the lower limit %f", (double)out);
}

/* pr: y = (kr (e - e[n-2]) + c1 y[n-1] + c2 y[n-2]) / den, clamped */
ZTEST(realtimelib, test_pr_difference_equation_and_limits)
{
	PR_Obj obj = {0};
	PR_Handle pr = PR_init(&obj, sizeof(obj));
	const float inv_den = 0.5f, c1 = 1.0f, c2 = -0.5f;
	float prev = 0.0f, prev2 = 0.0f, err1 = 0.0f, err2 = 0.0f;
	const float feedback[] = {-1.0f, -0.5f, 0.25f, 0.75f, -0.1f};

	zassert_not_null(pr, "PR_init");
	zassert_is_null(PR_init(&obj, 1), "a too small buffer must be rejected");

	obj.kr = 2.0f;
	obj.outMin = -10.0f;
	obj.outMax = 10.0f;

	for (size_t i = 0; i < ARRAY_SIZE(feedback); i++) {
		float error = -feedback[i];
		float want = (obj.kr * (error - err2) + prev * c1 + prev2 * c2) * inv_den;

		obj.Feedback = feedback[i];
		PR_run(pr, inv_den, c1, c2);
		zassert_within(obj.out, want, TOL, "sample %u: got %f, want %f", (unsigned int)i,
			       (double)obj.out, (double)want);

		prev2 = prev;
		prev = want;
		err2 = err1;
		err1 = error;
	}

	/* The output is limited */
	obj.outMax = 0.1f;
	obj.outMin = -0.1f;
	obj.Feedback = -100.0f;
	PR_run(pr, inv_den, c1, c2);
	zassert_within(obj.out, 0.1f, TOL, "upper limit %f", (double)obj.out);
}

/* vs_freq: output voltage follows a V/f line between a boost and a rated point */
ZTEST(realtimelib, test_vs_freq_profile)
{
	VS_FREQ_Obj obj = {0};
	VS_FREQ_Handle vf = VS_FREQ_init(&obj, sizeof(obj));

	zassert_not_null(vf, "VS_FREQ_init");
	obj.maxVsMag_pu = 0.9f;
	VS_FREQ_setProfile(vf, 0.1f, 0.5f, 0.05f, 0.45f);

	/* Slope: (0.45 - 0.05) / (0.5 - 0.1) = 1.0 */
	zassert_within(obj.VfSlope, 1.0f, TOL, "slope %f", (double)obj.VfSlope);

	VS_FREQ_run(vf, 0.0f);
	zassert_within(obj.Vs_out, 0.05f, TOL, "below the low point: boost voltage");
	VS_FREQ_run(vf, 0.1f);
	zassert_within(obj.Vs_out, 0.05f, TOL, "at the low point");
	VS_FREQ_run(vf, 0.3f);
	zassert_within(obj.Vs_out, 0.25f, TOL, "on the line %f", (double)obj.Vs_out);
	VS_FREQ_run(vf, 0.5f);
	zassert_within(obj.Vs_out, 0.45f, TOL, "at the rated point");
	VS_FREQ_run(vf, 0.9f);
	zassert_within(obj.Vs_out, 0.45f, TOL, "above the rated point: held");
}

ZTEST(realtimelib, test_vs_freq_direction_and_dq_split)
{
	VS_FREQ_Obj obj = {0};
	VS_FREQ_Handle vf = VS_FREQ_init(&obj, sizeof(obj));
	float vd, vq_fwd, vq_rev;

	obj.maxVsMag_pu = 0.9f;
	VS_FREQ_setProfile(vf, 0.1f, 0.5f, 0.05f, 0.45f);

	VS_FREQ_run(vf, 0.3f);
	vd = VS_FREQ_getVd_out(vf);
	vq_fwd = VS_FREQ_getVq_out(vf);
	VS_FREQ_run(vf, -0.3f);
	vq_rev = VS_FREQ_getVq_out(vf);

	/* The d axis is a fixed 0.3 share of the magnitude */
	zassert_within(vd, 0.25f * 0.3f, TOL, "d share %f", (double)vd);
	zassert_within(VS_FREQ_getVd_out(vf), vd, TOL, "d is unchanged");

	/*
	 * The magnitude depends on |frequency|. VS_FREQ_run() takes fabsf() of the input and
	 * then tests Freq > 0 to pick the q sign, so the negative branch is only reachable at
	 * exactly 0 Hz and a negative frequency gives the same Vq as a positive one. This is
	 * how the module behaves as delivered, and it is checked here so a change is noticed.
	 */
	zassert_within(vq_rev, vq_fwd, TOL, "q is the same for either direction");

	VS_FREQ_run(vf, 0.0f);
	zassert_true(VS_FREQ_getVq_out(vf) <= 0.0f, "q sign flips only at zero frequency");
}

/* fwc: no run function, only parameter storage around a PI controller */
ZTEST(realtimelib, test_fwc_params_and_enable)
{
	FWC_Obj obj;
	FWC_Handle fwc = FWC_init(&obj, sizeof(obj));

	zassert_not_null(fwc, "FWC_init");
	zassert_is_null(FWC_init(&obj, 1), "a too small buffer must be rejected");

	FWC_setParams(fwc, 1.5f, 0.25f, 0.1f, 1.2f);
	zassert_within(obj.pi.Kp, 1.5f, TOL, "Kp");
	zassert_within(obj.pi.Ki, 0.25f, TOL, "Ki");
	zassert_within(obj.pi.Ui, 0.0f, TOL, "integrator starts at zero");

	FWC_setCurrentAngle_rad(fwc, 0.6f);
	zassert_within(FWC_getCurrentAngle_rad(fwc), 0.6f, TOL, "angle");

	FWC_setFlagEnable(fwc, true);
	zassert_true(FWC_getFlagEnable(fwc), "enabled");
	FWC_disable(fwc);
	zassert_false(FWC_getFlagEnable(fwc), "disabled");
	FWC_enable(fwc);
	zassert_true(FWC_getFlagEnable(fwc), "enabled again");
}

/* vib_comp: state only, the learning table is not checked */
ZTEST(realtimelib, test_vib_comp_init_and_disabled_output)
{
	/* The object holds a 361 entry table, too big for the test stack */
	static VIB_COMP_Obj obj;
	VIB_COMP_Handle vc = VIB_COMP_init(&obj, sizeof(obj));
	float out;

	zassert_not_null(vc, "VIB_COMP_init");
	zassert_is_null(VIB_COMP_init(&obj, 1), "a too small buffer must be rejected");

	VIB_COMP_reset(vc);
	VIB_COMP_setFlag_enableOutput(vc, false);
	VIB_COMP_setAlphaGain(vc, 0.9f, 0.1f);

	/* With the output disabled the compensation current is zero */
	out = VIB_COMP_run(vc, 0.5f, 1.0f);
	(void)out;
	zassert_within(obj.Iq_outFF_A, 0.0f, TOL, "no feedforward while disabled");
}

/* dclink_ss: state only, the PWM timing algorithms are not checked */
ZTEST(realtimelib, test_dclink_ss_initial_conditions)
{
	DCLINK_SS_Obj obj;
	DCLINK_SS_Handle ss = DCLINK_SS_init(&obj, sizeof(obj));

	zassert_not_null(ss, "DCLINK_SS_init");
	zassert_is_null(DCLINK_SS_init(&obj, 1), "a too small buffer must be rejected");

	DCLINK_SS_setInitialConditions(ss, 2000, 0.75f);
	zassert_equal(obj.pwmPeriod, 2000, "PWM period");
	zassert_within(obj.SSTOffThrVs_pu, 0.75f, TOL, "threshold");
	zassert_equal(obj.minAvDuration, 90, "default minimum AV duration");
	zassert_equal(obj.sampleDelay, 50, "default sample delay");
	zassert_within(obj.I_A.value[0], 0.0f, TOL, "currents start at zero");

	DCLINK_SS_setMinAVDuration(ss, 120);
	DCLINK_SS_setSampleDelay(ss, 70);
	zassert_equal(obj.minAvDuration, 120, "minimum AV duration");
	zassert_equal(obj.sampleDelay, 70, "sample delay");
}
```

## src/test_datalog.c
```c
/*
 * Copyright (c) 2026 Texas Instruments Incorporated
 *
 * SPDX-License-Identifier: BSD-3-Clause
 */

#include <zephyr/ztest.h>

#include <datalog.h>
#include <dlog_2ch_f.h>
#include <dlog_4ch_f.h>
#include <dlog_6ch_f.h>

/* datalog: copies four inputs into the capture buffers, one sample per update */
ZTEST(realtimelib, test_datalog_init_rejects_small_buffer)
{
	DATALOG_Obj obj;
	DATALOG_Handle h = DATALOG_init(&obj, sizeof(obj));

	zassert_not_null(h, "DATALOG_init");
	zassert_equal(obj.size, DATA_LOG_BUFF_SIZE, "default size");
	zassert_equal(obj.cntr, 0, "counter cleared");
	zassert_is_null(DATALOG_init(&obj, 1), "a too small buffer must be rejected");
}

ZTEST(realtimelib, test_datalog_captures_and_wraps)
{
	DATALOG_Obj obj;
	DATALOG_Handle h = DATALOG_init(&obj, sizeof(obj));
	float in[DATA_LOG_BUFF_NUM];

	for (int i = 0; i < DATA_LOG_BUFF_NUM; i++) {
		obj.iptr[i] = &in[i];
	}
	obj.flag_enableLogData = true;
	obj.flag_enableLogOneShot = false;
	obj.size = 3;

	for (int n = 0; n < 4; n++) {
		in[0] = 10.0f + n;
		in[1] = 20.0f + n;
		in[2] = 30.0f + n;
		in[3] = 40.0f + n;
		DATALOG_update(h);
	}

	/* Samples 0..2 fill the buffers, sample 3 wraps to index 0 and overwrites it */
	zassert_equal(obj.cntr, 1, "counter after wrap");
	zassert_within(datalogBuff1[0], 13.0f, 1.0e-6f, "buffer 1 wrapped");
	zassert_within(datalogBuff1[1], 11.0f, 1.0e-6f, "buffer 1 [1]");
	zassert_within(datalogBuff1[2], 12.0f, 1.0e-6f, "buffer 1 [2]");
	zassert_within(datalogBuff2[0], 23.0f, 1.0e-6f, "buffer 2");
	zassert_within(datalogBuff3[1], 31.0f, 1.0e-6f, "buffer 3");
	zassert_within(datalogBuff4[2], 42.0f, 1.0e-6f, "buffer 4");
	zassert_true(obj.flag_enableLogData, "continuous logging keeps running");
}

ZTEST(realtimelib, test_datalog_one_shot_stops_after_one_pass)
{
	DATALOG_Obj obj;
	DATALOG_Handle h = DATALOG_init(&obj, sizeof(obj));
	float in[DATA_LOG_BUFF_NUM] = {1.0f, 2.0f, 3.0f, 4.0f};

	for (int i = 0; i < DATA_LOG_BUFF_NUM; i++) {
		obj.iptr[i] = &in[i];
	}
	obj.size = 2;
	obj.flag_enableLogData = false;
	obj.flag_enableLogOneShot = true;

	/* A one-shot request arms the logger and rewinds it; nothing is stored yet */
	DATALOG_update(h);
	zassert_true(obj.flag_enableLogData, "armed");
	zassert_equal(obj.cntr, 0, "rewound");

	in[0] = 5.0f;
	DATALOG_update(h);
	in[0] = 6.0f;
	DATALOG_update(h);
	zassert_equal(obj.cntr, 2, "two samples stored");
	zassert_within(datalogBuff1[0], 5.0f, 1.0e-6f, "first sample");
	zassert_within(datalogBuff1[1], 6.0f, 1.0e-6f, "second sample");

	/* The next update finds the buffer full, stops, and still stores that one sample at 0 */
	in[0] = 7.0f;
	DATALOG_update(h);
	zassert_false(obj.flag_enableLogData, "stopped after one pass");
	zassert_false(obj.flag_enableLogOneShot, "one-shot cleared");

	in[0] = 8.0f;
	DATALOG_update(h);
	zassert_true(obj.flag_enableLogData == false, "stays stopped");
}

ZTEST(realtimelib, test_datalog_disabled_stores_nothing)
{
	DATALOG_Obj obj;
	DATALOG_Handle h = DATALOG_init(&obj, sizeof(obj));
	float in[DATA_LOG_BUFF_NUM] = {1.0f, 2.0f, 3.0f, 4.0f};

	for (int i = 0; i < DATA_LOG_BUFF_NUM; i++) {
		obj.iptr[i] = &in[i];
	}
	obj.flag_enableLogData = false;
	obj.flag_enableLogOneShot = false;
	datalogBuff1[0] = -99.0f;

	DATALOG_update(h);
	zassert_equal(obj.cntr, 0, "counter unchanged");
	zassert_within(datalogBuff1[0], -99.0f, 1.0e-6f, "buffer untouched");
}

/* dlog_2ch_f: wait for a rising edge through the trigger, then log every pre_scalar-th sample */
ZTEST(realtimelib, test_dlog_2ch_triggers_and_logs)
{
	DLOG_2CH_F d;
	float in1 = 0.0f, in2 = 0.0f, out1[3] = {0}, out2[3] = {0};

	DLOG_2CH_F_init(&d);
	zassert_equal(d.status, 0, "init clears the state");

	d.input_ptr1 = &in1;
	d.input_ptr2 = &in2;
	d.output_ptr1 = out1;
	d.output_ptr2 = out2;
	d.trig_value = 0.5f;
	d.pre_scalar = 2;
	d.size = 3;
	d.status = 1;

	/* Below the trigger, nothing is logged */
	in1 = 0.2f;
	DLOG_2CH_F_FUNC(&d);
	zassert_equal(d.status, 1, "still waiting");

	/* Rising through 0.5 starts the capture (this sample is not stored) */
	in1 = 0.8f;
	DLOG_2CH_F_FUNC(&d);
	zassert_equal(d.status, 2, "triggered");
	zassert_equal(d.count, 0, "nothing stored on the trigger sample");

	/* pre_scalar = 2: every second sample is stored */
	for (int n = 0; n < 6; n++) {
		in1 = 1.0f + n;
		in2 = -1.0f - n;
		DLOG_2CH_F_FUNC(&d);
	}
	zassert_within(out1[0], 2.0f, 1.0e-6f, "first stored sample");
	zassert_within(out1[1], 4.0f, 1.0e-6f, "second stored sample");
	zassert_within(out1[2], 6.0f, 1.0e-6f, "third stored sample");
	zassert_within(out2[0], -2.0f, 1.0e-6f, "channel 2 follows");
	zassert_within(out2[2], -6.0f, 1.0e-6f, "channel 2 last");

	/* A full buffer rearms the trigger */
	zassert_equal(d.status, 1, "waiting again");
	zassert_equal(d.count, 0, "counter rewound");
}

ZTEST(realtimelib, test_dlog_2ch_needs_a_rising_edge)
{
	DLOG_2CH_F d;
	float in1 = 0.9f, in2 = 0.0f, out1[2] = {0}, out2[2] = {0};

	DLOG_2CH_F_init(&d);
	d.input_ptr1 = &in1;
	d.input_ptr2 = &in2;
	d.output_ptr1 = out1;
	d.output_ptr2 = out2;
	d.trig_value = 0.5f;
	d.pre_scalar = 1;
	d.size = 2;
	d.status = 1;
	d.prev_value = 0.9f;

	/* Falling through the trigger must not start the capture */
	in1 = 0.1f;
	DLOG_2CH_F_FUNC(&d);
	zassert_equal(d.status, 1, "falling edge ignored");
}

/* dlog_4ch_f / dlog_6ch_f: the macro and the function behave the same way */
ZTEST(realtimelib, test_dlog_4ch_macro_and_function_agree)
{
	DLOG_4CH_F a, b;
	float in[4] = {0}, oa[4][2] = {{0}}, ob[4][2] = {{0}};

	DLOG_4CH_F_init(&a);
	DLOG_4CH_F_init(&b);
	for (int i = 0; i < 4; i++) {
		(&a.input_ptr1)[i] = &in[i];
		(&b.input_ptr1)[i] = &in[i];
		(&a.output_ptr1)[i] = oa[i];
		(&b.output_ptr1)[i] = ob[i];
	}
	a.trig_value = b.trig_value = 0.5f;
	a.pre_scalar = b.pre_scalar = 1;
	a.size = b.size = 2;
	a.status = b.status = 1;

	for (int n = 0; n < 5; n++) {
		in[0] = (n == 0) ? 0.0f : 1.0f + n;
		in[1] = 10.0f + n;
		in[2] = 20.0f + n;
		in[3] = 30.0f + n;
		DLOG_4CH_F_MACRO(a);
		DLOG_4CH_F_FUNC(&b);
		zassert_equal(a.status, b.status, "status step %d", n);
		zassert_equal(a.count, b.count, "count step %d", n);
	}
	for (int c = 0; c < 4; c++) {
		for (int k = 0; k < 2; k++) {
			zassert_within(oa[c][k], ob[c][k], 1.0e-6f, "ch %d [%d]", c, k);
		}
	}
	zassert_true(oa[3][0] > 0.0f, "data was captured");
}

/* dlog_6ch_f: unlike the other two, it triggers on any change of channel 0 */
ZTEST(realtimelib, test_dlog_6ch_triggers_on_change_and_logs)
{
	DLOG_6CH_F d;
	float in[DLOG_CH_NUM] = {0};
	static float out[DLOG_CH_NUM][2];

	DLOG_6CH_F_init(&d);
	zassert_equal(d.preScalar, 10, "default pre-scaler");
	zassert_equal(d.size, DLOG_BUF_SIZE, "default size");

	for (int c = 0; c < DLOG_CH_NUM; c++) {
		d.input_ptr[c] = &in[c];
		d.output_ptr[c] = out[c];
	}
	d.preScalar = 1;
	d.size = 2;

	/* Status 0 only arms the logger */
	DLOG_6CH_F_FUNC(&d);
	zassert_equal(d.status, 1, "armed");

	/* An unchanged channel 0 does not trigger */
	DLOG_6CH_F_FUNC(&d);
	zassert_equal(d.status, 1, "no change, no trigger");

	/* A change triggers; that sample is not stored */
	in[0] = 1.0f;
	DLOG_6CH_F_FUNC(&d);
	zassert_equal(d.status, 2, "triggered");
	zassert_equal(d.count, 0, "nothing stored yet");

	for (int n = 0; n < 2; n++) {
		for (int c = 0; c < DLOG_CH_NUM; c++) {
			in[c] = 100.0f * c + 10.0f * n + 1.0f;
		}
		DLOG_6CH_F_FUNC(&d);
	}

	for (int c = 0; c < DLOG_CH_NUM; c++) {
		zassert_within(out[c][0], 100.0f * c + 1.0f, 1.0e-6f, "ch %d first", c);
		zassert_within(out[c][1], 100.0f * c + 11.0f, 1.0e-6f, "ch %d second", c);
	}
	zassert_equal(d.status, 1, "waiting again after a full buffer");
}
```

## src/test_filters.c
```c
/*
 * Copyright (c) 2026 Texas Instruments Incorporated
 *
 * SPDX-License-Identifier: BSD-3-Clause
 */

#include <math.h>

#include <zephyr/ztest.h>

#include <filter_notch.h>
#include <filter_so.h>
#include <offset.h>
#include <volt_calc.h>
#include <volt_recons.h>

#define TOL 1.0e-4f

/* filter_so: y[n] = b0 x[n] + b1 x[n-1] + b2 x[n-2] - a1 y[n-1] - a2 y[n-2] */
ZTEST(realtimelib, test_filter_so_step_response)
{
	FILTER_SO_Obj obj;
	FILTER_SO_Handle f = FILTER_SO_init(&obj, sizeof(obj));
	float y;

	zassert_not_null(f, "FILTER_SO_init");

	/* A pure 3-tap average: unity DC gain, no feedback */
	FILTER_SO_set_a1(f, 0.0f);
	FILTER_SO_set_a2(f, 0.0f);
	FILTER_SO_set_b0(f, 1.0f / 3.0f);
	FILTER_SO_set_b1(f, 1.0f / 3.0f);
	FILTER_SO_set_b2(f, 1.0f / 3.0f);
	FILTER_SO_set_x1(f, 0.0f);
	FILTER_SO_set_x2(f, 0.0f);
	FILTER_SO_set_y1(f, 0.0f);
	FILTER_SO_set_y2(f, 0.0f);

	y = FILTER_SO_run(f, 3.0f);
	zassert_within(y, 1.0f, TOL, "first sample %f", (double)y);
	y = FILTER_SO_run(f, 3.0f);
	zassert_within(y, 2.0f, TOL, "second sample %f", (double)y);
	y = FILTER_SO_run(f, 3.0f);
	zassert_within(y, 3.0f, TOL, "third sample %f", (double)y);
	y = FILTER_SO_run(f, 3.0f);
	zassert_within(y, 3.0f, TOL, "holds the DC level %f", (double)y);
}

ZTEST(realtimelib, test_filter_so_feedback)
{
	FILTER_SO_Obj obj;
	FILTER_SO_Handle f = FILTER_SO_init(&obj, sizeof(obj));
	float y = 0.0f;

	/* y[n] = x[n] + 0.5 y[n-1]: an impulse decays by half each sample */
	FILTER_SO_set_a1(f, -0.5f);
	FILTER_SO_set_a2(f, 0.0f);
	FILTER_SO_set_b0(f, 1.0f);
	FILTER_SO_set_b1(f, 0.0f);
	FILTER_SO_set_b2(f, 0.0f);
	FILTER_SO_set_x1(f, 0.0f);
	FILTER_SO_set_x2(f, 0.0f);
	FILTER_SO_set_y1(f, 0.0f);
	FILTER_SO_set_y2(f, 0.0f);

	y = FILTER_SO_run(f, 1.0f);
	zassert_within(y, 1.0f, TOL, "impulse %f", (double)y);
	y = FILTER_SO_run(f, 0.0f);
	zassert_within(y, 0.5f, TOL, "decay 1 %f", (double)y);
	y = FILTER_SO_run(f, 0.0f);
	zassert_within(y, 0.25f, TOL, "decay 2 %f", (double)y);
}

ZTEST(realtimelib, test_filter_so_second_order_feedback)
{
	FILTER_SO_Obj obj;
	FILTER_SO_Handle f = FILTER_SO_init(&obj, sizeof(obj));
	float y;

	/* y[n] = x[n] + 0.5 y[n-1] - 0.25 y[n-2], so an impulse gives 1, 0.5, 0, -0.125 */
	FILTER_SO_set_a1(f, -0.5f);
	FILTER_SO_set_a2(f, 0.25f);
	FILTER_SO_set_b0(f, 1.0f);
	FILTER_SO_set_b1(f, 0.0f);
	FILTER_SO_set_b2(f, 0.0f);
	FILTER_SO_set_x1(f, 0.0f);
	FILTER_SO_set_x2(f, 0.0f);
	FILTER_SO_set_y1(f, 0.0f);
	FILTER_SO_set_y2(f, 0.0f);

	y = FILTER_SO_run(f, 1.0f);
	zassert_within(y, 1.0f, TOL, "n=0 %f", (double)y);
	y = FILTER_SO_run(f, 0.0f);
	zassert_within(y, 0.5f, TOL, "n=1 %f", (double)y);
	y = FILTER_SO_run(f, 0.0f);
	zassert_within(y, 0.0f, TOL, "n=2 %f", (double)y);
	y = FILTER_SO_run(f, 0.0f);
	zassert_within(y, -0.125f, TOL, "n=3 %f", (double)y);
}

ZTEST(realtimelib, test_filter_so_init_rejects_small_buffer)
{
	FILTER_SO_Obj obj;

	zassert_is_null(FILTER_SO_init(&obj, 1), "a too small buffer must be rejected");
}

/* notch: coefficients from FILTER_COEFF_update, then a difference equation */
ZTEST(realtimelib, test_notch_coefficients)
{
	FILTER_NOTCH_CoeffObj cobj;
	FILTER_NOTCH_Coeff_Handle coeff = FILTER_COEFF_init(&cobj, sizeof(cobj));
	const float ts = 1.0e-4f, freq = 50.0f, c2 = 0.1f, c1 = 1.0f;
	const float wn = 2.0f * MATH_TWO_PI * freq;
	const float x = 2.0f * c2 * wn * ts;
	const float y = 2.0f * c1 * wn * ts;
	const float z = wn * ts * wn * ts;

	zassert_not_null(coeff, "FILTER_COEFF_init");
	FILTER_COEFF_update(coeff, ts, freq, c2, c1);

	zassert_within(cobj.b0, 1.0f, TOL, "b0");
	zassert_within(cobj.b1, x - 2.0f, TOL, "b1 %f", (double)cobj.b1);
	zassert_within(cobj.b2, z - x + 1.0f, TOL, "b2 %f", (double)cobj.b2);
	zassert_within(cobj.a1, -(y - 2.0f), TOL, "a1 %f", (double)cobj.a1);
	zassert_within(cobj.a2, -(z - y + 1.0f), TOL, "a2 %f", (double)cobj.a2);
}

ZTEST(realtimelib, test_notch_run_matches_difference_equation)
{
	FILTER_NOTCH_CoeffObj cobj;
	FILTER_NOTCH_Obj fobj;
	FILTER_NOTCH_Coeff_Handle coeff = FILTER_COEFF_init(&cobj, sizeof(cobj));
	FILTER_NOTCH_Handle notch = FILTER_NOTCH_init(&fobj, sizeof(fobj));
	const float input[] = {1.0f, 0.5f, -0.25f, 0.8f, 0.0f, -1.0f};
	float in1 = 0.0f, in2 = 0.0f, out1 = 0.0f, out2 = 0.0f;

	FILTER_COEFF_update(coeff, 1.0e-4f, 50.0f, 0.1f, 1.0f);
	FILTER_NOTCH_reset(notch);

	for (size_t i = 0; i < ARRAY_SIZE(input); i++) {
		float want = cobj.a1 * out1 + cobj.a2 * out2 + cobj.b0 * input[i] +
			     cobj.b1 * in1 + cobj.b2 * in2;
		float got;

		FILTER_NOTCH_set_in(notch, input[i]);
		got = FILTER_NOTCH_run(notch, coeff);
		zassert_within(got, want, TOL, "sample %u: got %f, want %f", (unsigned int)i,
			       (double)got, (double)want);

		in2 = in1;
		in1 = input[i];
		out2 = out1;
		out1 = want;
	}
}

/* offset: a low-pass that tracks a slowly varying offset, unity DC gain */
ZTEST(realtimelib, test_offset_settles_to_constant_input)
{
	OFFSET_Obj obj;
	OFFSET_Handle off = OFFSET_init(&obj, sizeof(obj));

	zassert_not_null(off, "OFFSET_init");
	OFFSET_setInitCond(off, 0.0f);
	OFFSET_setBeta(off, 0.5f);

	for (int i = 0; i < 400; i++) {
		OFFSET_run(off, 2.0f);
	}
	zassert_within(obj.value, 2.0f, 1.0e-3f, "offset %f", (double)obj.value);
}

ZTEST(realtimelib, test_offset_init_condition_and_override)
{
	OFFSET_Obj obj;
	OFFSET_Handle off = OFFSET_init(&obj, sizeof(obj));

	OFFSET_setBeta(off, 0.5f);
	OFFSET_setInitCond(off, 1.5f);
	zassert_within(obj.value, 1.5f, TOL, "initial condition");

	/* Held at the initial condition, a matching input does not move it */
	OFFSET_run(off, 1.5f);
	zassert_within(obj.value, 1.5f, TOL, "stays put %f", (double)obj.value);

	OFFSET_setOffset(off, -0.75f);
	zassert_within(obj.value, -0.75f, TOL, "forced value");
}

/* volts: phase voltages from the duty cycles, Vphase_a = Vdc/3 * (2a - b - c) */
ZTEST(realtimelib, test_phvolc_phase_voltages)
{
	PHVOLC_Obj obj = {0};
	PHVOLC_Handle h = (PHVOLC_Handle)&obj;
	MATH_Vec3 duty = {{0.8f, 0.2f, 0.5f}};
	MATH_Vec2 unused;
	const float vdc = 24.0f;

	/* The results are stored in the object (the Vab output argument is not written) */
	PHVOLC_run(h, vdc, &duty, &unused);

	zassert_within(obj.VphaseA, vdc / 3.0f * (2.0f * 0.8f - 0.2f - 0.5f), TOL, "A %f",
		       (double)obj.VphaseA);
	zassert_within(obj.VphaseB, vdc / 3.0f * (2.0f * 0.2f - 0.8f - 0.5f), TOL, "B %f",
		       (double)obj.VphaseB);
	zassert_within(obj.VphaseC, vdc / 3.0f * (2.0f * 0.5f - 0.2f - 0.8f), TOL, "C %f",
		       (double)obj.VphaseC);

	/* The three phase voltages of a balanced star load sum to zero */
	zassert_within(obj.VphaseA + obj.VphaseB + obj.VphaseC, 0.0f, TOL, "sum");
	zassert_within(obj.Valpha, obj.VphaseA, TOL, "alpha");
	zassert_within(obj.Vbeta, (obj.VphaseA + 2.0f * obj.VphaseB) / 1.7320508f, TOL, "beta");
}

ZTEST(realtimelib, test_phvolc_out_of_phase_flips_sign)
{
	PHVOLC_Obj obj = {0};
	PHVOLC_Handle h = (PHVOLC_Handle)&obj;
	MATH_Vec3 duty = {{0.8f, 0.2f, 0.5f}};
	MATH_Vec2 unused;
	float alpha, beta;

	PHVOLC_run(h, 24.0f, &duty, &unused);
	alpha = obj.Valpha;
	beta = obj.Vbeta;
	obj.flagOutOfPhase = 1;
	PHVOLC_run(h, 24.0f, &duty, &unused);

	zassert_within(obj.Valpha, -alpha, TOL, "alpha flipped");
	zassert_within(obj.Vbeta, -beta, TOL, "beta flipped");
}

ZTEST(realtimelib, test_volrec_init_reset_and_params)
{
	VOLREC_Obj obj;
	VOLREC_Handle h = VOLREC_init(&obj, sizeof(obj));

	zassert_not_null(h, "VOLREC_init");
	zassert_is_null(VOLREC_init(&obj, 1), "a too small buffer must be rejected");

	VOLREC_setParams(h, 1000.0f, 10000.0f);
	/* Low-pass coefficients: beta = pole / rate, a1 = (b-2)/(b+2), b0 = b1 = b/(b+2) */
	zassert_within(obj.a1, (0.1f - 2.0f) / (0.1f + 2.0f), TOL, "a1 %f", (double)obj.a1);
	zassert_within(obj.b0, 0.1f / (0.1f + 2.0f), TOL, "b0 %f", (double)obj.b0);
	zassert_within(obj.b1, obj.b0, TOL, "b1");
	zassert_within(obj.sf, 0.925f, TOL, "default scale factor %f", (double)obj.sf);

	obj.sf = 0.9f;
	obj.numSamples = 7;
	VOLREC_reset(h);
	zassert_within(obj.sf, 1.0f, TOL, "reset restores the scale factor");
	zassert_equal(obj.numSamples, 0, "reset clears the sample count");
}
```

## src/test_motorvision.c
```c
/*
 * Copyright (c) 2026 Texas Instruments Incorporated
 *
 * SPDX-License-Identifier: BSD-3-Clause
 */

#include <string.h>

#include <zephyr/devicetree.h>
#include <zephyr/drivers/serial/uart_emul.h>
#include <zephyr/kernel.h>
#include <zephyr/ztest.h>

#include <motorvision.h>
#include <motorvision_sine_generator.h>

#define MV_START 115
#define MV_END   101
#define MV_PACKET_SIZE 16

/* Commands used below (enum MV_CMDS in motorvision.c) */
#define CMD_PACKET_ERROR 39
#define CMD_INIT         40
#define CMD_WRITE_VAR    43
#define CMD_INIT_STREAM  44
#define CMD_START_A      45
#define CMD_START_POLL_1 63
#define CMD_POLLING_DATA 77
#define CMD_CLEAR_PLOT   78
#define CMD_STREAM_1_VAR 53

static const struct device *const uart = DEVICE_DT_GET(DT_NODELABEL(mv_uart));

/* The application variable table that MotorVision reads and writes */
static volatile bool mv_bool = true;
static volatile float mv_float;

#define HASH_U16   0
#define HASH_U32   5
#define HASH_BOOL  6
#define HASH_FLOAT 13

volatile void *MVHASH_hash_table[MVHASH_NUMBER_OF_VARIABLES];
int16_t MVHASH_uint16_t_startIndex = HASH_U16;
int16_t MVHASH_uint32_t_startIndex = HASH_U32;
int16_t MVHASH_int16_t_startIndex = -1;
int16_t MVHASH_int32_t_startIndex = -1;
int16_t MVHASH_bool_startIndex = HASH_BOOL;
int16_t MVHASH_float_startIndex = HASH_FLOAT;

static void *setup(void)
{
	for (size_t i = 0; i < MVHASH_NUMBER_OF_VARIABLES; i++) {
		MVHASH_hash_table[i] = &mv_float;
	}
	MVHASH_hash_table[HASH_U16] = &rw_var_6;
	MVHASH_hash_table[HASH_U32] = &rw_var_3;
	MVHASH_hash_table[HASH_BOOL] = &mv_bool;
	MVHASH_hash_table[HASH_FLOAT] = &sine_wave1;

	return NULL;
}

static void before(void *unused)
{
	ARG_UNUSED(unused);

	zassert_true(device_is_ready(uart), "emulated UART not ready");
	uart_emul_flush_rx_data(uart);
	uart_emul_flush_tx_data(uart);
	MOTORVISION_init((void *)uart);
}

/* Feed one 16 byte packet: START, command, 12 payload bytes, END */
static void send_packet(uint8_t cmd, const uint8_t *payload, size_t len)
{
	uint8_t pkt[MV_PACKET_SIZE] = {0};

	pkt[0] = MV_START;
	pkt[1] = cmd;
	memcpy(&pkt[2], payload, len);
	pkt[MV_PACKET_SIZE - 1] = MV_END;

	zassert_equal(uart_emul_put_rx_data(uart, pkt, sizeof(pkt)), sizeof(pkt));
	/* The emulated UART delivers the bytes from a work queue */
	k_msleep(100);
}

static size_t read_tx(uint8_t *buf, size_t size)
{
	return uart_emul_get_tx_data(uart, buf, size);
}

/* The next call of the polling function sends the acknowledge of the last command */
static void expect_ack(uint8_t cmd)
{
	uint8_t tx[8];
	size_t n;

	MOTORVISION_captureAndSendPollingData();
	n = read_tx(tx, sizeof(tx));
	zassert_equal(n, 3, "ack length %u", (unsigned int)n);
	zassert_equal(tx[0], MV_START, "start byte");
	zassert_equal(tx[1], cmd, "ack of command %u, got %u", cmd, tx[1]);
	zassert_equal(tx[2], MV_END, "end byte");
}

ZTEST(motorvision, test_init_command_is_acknowledged)
{
	send_packet(CMD_INIT, NULL, 0);
	expect_ack(CMD_INIT);

	/* Nothing more to send once the acknowledge is out and nothing is polled */
	MOTORVISION_captureAndSendPollingData();
	zassert_equal(read_tx(&(uint8_t){0}, 1), 0, "no extra bytes");
}

ZTEST(motorvision, test_bad_packet_gives_error)
{
	uint8_t pkt[MV_PACKET_SIZE] = {MV_START, CMD_INIT};

	/* The end byte is missing */
	pkt[MV_PACKET_SIZE - 1] = 0x00;
	zassert_equal(uart_emul_put_rx_data(uart, pkt, sizeof(pkt)), sizeof(pkt));
	k_msleep(100);

	expect_ack(CMD_PACKET_ERROR);
}

ZTEST(motorvision, test_unknown_command_gives_error)
{
	send_packet(0xEE, NULL, 0);
	expect_ack(CMD_PACKET_ERROR);
}

ZTEST(motorvision, test_polling_sends_variable_value)
{
	const uint8_t idx[] = {HASH_U16};
	uint8_t tx[16];

	rw_var_6 = 0x1234;
	send_packet(CMD_INIT, NULL, 0);
	expect_ack(CMD_INIT);

	send_packet(CMD_START_POLL_1, idx, sizeof(idx));
	expect_ack(CMD_START_POLL_1);
	zassert_equal(MV_pollingArraySize, 1, "one polling variable");

	/* START, POLLING_DATA, hash index, value low byte, value high byte, END */
	MOTORVISION_captureAndSendPollingData();
	zassert_equal(read_tx(tx, sizeof(tx)), 6, "polling packet length");
	zassert_equal(tx[0], MV_START);
	zassert_equal(tx[1], CMD_POLLING_DATA);
	zassert_equal(tx[2], HASH_U16);
	zassert_equal(tx[3], 0x34, "low byte");
	zassert_equal(tx[4], 0x12, "high byte");
	zassert_equal(tx[5], MV_END);
}

ZTEST(motorvision, test_write_variables)
{
	/* hash index, then the value most significant byte first */
	const uint8_t w16[] = {HASH_U16, 0xAB, 0xCD};
	const uint8_t w32[] = {HASH_U32, 0x12, 0x34, 0x56, 0x78};
	const uint8_t wbool[] = {HASH_BOOL, 0x00, 0x00};

	send_packet(CMD_WRITE_VAR, w16, sizeof(w16));
	zassert_equal(rw_var_6, 0xABCD, "uint16 write 0x%04x", rw_var_6);
	expect_ack(CMD_WRITE_VAR);

	send_packet(CMD_WRITE_VAR, w32, sizeof(w32));
	zassert_equal(rw_var_3, 0x12345678U, "uint32 write 0x%08x", (unsigned int)rw_var_3);
	expect_ack(CMD_WRITE_VAR);

	mv_bool = true;
	send_packet(CMD_WRITE_VAR, wbool, sizeof(wbool));
	zassert_false(mv_bool, "bool write");
	expect_ack(CMD_WRITE_VAR);
}

ZTEST(motorvision, test_stream_one_variable)
{
	const uint8_t vars[] = {HASH_FLOAT, HASH_FLOAT, HASH_FLOAT, HASH_FLOAT};
	static uint8_t tx[1024];
	size_t n;
	size_t packets = 0;

	send_packet(CMD_INIT, NULL, 0);
	expect_ack(CMD_INIT);
	send_packet(CMD_INIT_STREAM, vars, sizeof(vars));
	expect_ack(CMD_INIT_STREAM);
	send_packet(CMD_START_A, NULL, 0);
	expect_ack(CMD_START_A);

	/* 1.5f is 0x3FC00000, sent least significant byte first */
	sine_wave1 = 1.5f;

	/* The capture buffer holds 50 samples; the first send swaps buffers */
	for (int i = 0; i < 50; i++) {
		MOTORVISION_capturePlotData();
	}
	MOTORVISION_sendPlotData();
	zassert_equal(read_tx(tx, sizeof(tx)), 0, "nothing is sent until the swap");
	MOTORVISION_sendPlotData();

	n = read_tx(tx, sizeof(tx));
	/* A clear-plot command, then 50 packets of START, cmd, 4 value bytes, END */
	zassert_equal(n, 3 + 50 * 7, "stream length %u", (unsigned int)n);
	zassert_equal(tx[0], MV_START);
	zassert_equal(tx[1], CMD_CLEAR_PLOT, "clear plot first");
	zassert_equal(tx[2], MV_END);

	for (size_t off = 3; off < n; off += 7) {
		zassert_equal(tx[off], MV_START, "start at %u", (unsigned int)off);
		zassert_equal(tx[off + 1], CMD_STREAM_1_VAR);
		zassert_equal(tx[off + 2], 0x00);
		zassert_equal(tx[off + 3], 0x00);
		zassert_equal(tx[off + 4], 0xC0);
		zassert_equal(tx[off + 5], 0x3F);
		zassert_equal(tx[off + 6], MV_END);
		packets++;
	}
	zassert_equal(packets, 50);
}

ZTEST(motorvision, test_sine_generator)
{
	SineGen_init();
	zassert_within(amp1, 30.0f, 1.0e-6f, "amp");
	zassert_within(offset1, 50.0f, 1.0e-6f, "offset");

	/* At counter 1 the argument is freq1 = 0.01 rad */
	SineGen_update();
	zassert_within(sine_wave1, (50.0f - 60.0f * 0.0099998f) / 100.0f, 1.0e-3f, "wave 1 %f",
		       (double)sine_wave1);
	zassert_within(sine_wave2, (50.0f + 60.0f * 0.0099998f) / 100.0f, 1.0e-3f, "wave 2 %f",
		       (double)sine_wave2);
	zassert_equal(SM_isrCounter, 1, "counter");
}

ZTEST_SUITE(motorvision, NULL, setup, before, NULL, NULL);
```

## src/test_mtpa.c
```c
/*
 * Copyright (c) 2026 Texas Instruments Incorporated
 *
 * SPDX-License-Identifier: BSD-3-Clause
 */

#include <math.h>

#include <zephyr/ztest.h>

#include <mtpa.h>

#define TOL 1.0e-4f

#define LS_D_H (CONFIG_TI_REALTIMELIB_MTPA_LS_D_UH * 1.0e-6f)
#define LS_Q_H (CONFIG_TI_REALTIMELIB_MTPA_LS_Q_UH * 1.0e-6f)

/* kconst = 0.25 * flux / (Lq - Ld), or 0 for a non-salient motor */
ZTEST(realtimelib, test_mtpa_constant)
{
	MTPA_Obj obj = {0};
	MTPA_Handle h = MTPA_init(&obj, sizeof(obj));

	zassert_not_null(h, "MTPA_init");

	MTPA_computeParameters(h, 1.0e-3f, 2.0e-3f, 0.04f);
	zassert_within(MTPA_getKconst(h), 10.0f, TOL, "kconst %f", (double)MTPA_getKconst(h));

	MTPA_computeParameters(h, 2.0e-3f, 1.0e-3f, 0.04f);
	zassert_within(MTPA_getKconst(h), -10.0f, TOL, "Lq < Ld gives a negative constant");

	MTPA_computeParameters(h, 1.5e-3f, 1.5e-3f, 0.04f);
	zassert_within(MTPA_getKconst(h), 0.0f, TOL, "no saliency, no constant");
}

/* Id = k - sqrt(k^2 + Is^2 / 2), Iq = sqrt(Is^2 - Id^2) */
ZTEST(realtimelib, test_mtpa_current_reference)
{
	MTPA_Obj obj = {0};
	MTPA_Handle h = MTPA_init(&obj, sizeof(obj));
	const float k = 10.0f, is = 5.0f;
	const float id = k - sqrtf(k * k + 0.5f * is * is);

	MTPA_computeParameters(h, 1.0e-3f, 2.0e-3f, 0.04f);
	MTPA_enable(h);

	MTPA_computeCurrentReference(h, is);
	zassert_within(MTPA_getId_ref_A(h), id, TOL, "Id %f", (double)MTPA_getId_ref_A(h));
	zassert_true(MTPA_getId_ref_A(h) < 0.0f, "Id is negative for Lq > Ld");
	zassert_within(MTPA_getIq_ref_A(h), sqrtf(is * is - id * id), TOL, "Iq");
	zassert_within(MTPA_getIs_ref_A(h), is, TOL, "magnitude");

	/* The d and q references together keep the requested magnitude */
	zassert_within(MTPA_getId_ref_A(h) * MTPA_getId_ref_A(h) +
			       MTPA_getIq_ref_A(h) * MTPA_getIq_ref_A(h),
		       is * is, 1.0e-3f, "|Idq| is Is");

	/* A negative request flips Iq only */
	MTPA_computeCurrentReference(h, -is);
	zassert_within(MTPA_getId_ref_A(h), id, TOL, "Id unchanged for a negative request");
	zassert_true(MTPA_getIq_ref_A(h) < 0.0f, "Iq follows the sign");
	zassert_within(MTPA_getIs_ref_A(h), is, TOL, "magnitude is absolute");
}

ZTEST(realtimelib, test_mtpa_disabled_or_degenerate)
{
	MTPA_Obj obj = {0};
	MTPA_Handle h = MTPA_init(&obj, sizeof(obj));

	MTPA_computeParameters(h, 1.0e-3f, 2.0e-3f, 0.04f);

	/* Disabled: all of the request goes to the q axis, the angle is 90 degrees */
	MTPA_disable(h);
	MTPA_computeCurrentReference(h, 3.0f);
	zassert_within(MTPA_getId_ref_A(h), 0.0f, TOL, "Id");
	zassert_within(MTPA_getIq_ref_A(h), 3.0f, TOL, "Iq");
	zassert_within(MTPA_computeCurrentAngle(h, 3.0f), MATH_PI_OVER_TWO, TOL, "angle");

	/* Enabled, but zero current: same result */
	MTPA_enable(h);
	zassert_true(MTPA_getFlagEnable(h), "enabled");
	MTPA_computeCurrentReference(h, 0.0f);
	zassert_within(MTPA_getIq_ref_A(h), 0.0f, TOL, "Iq at zero current");
	zassert_within(MTPA_computeCurrentAngle(h, 0.0f), MATH_PI_OVER_TWO, TOL, "angle at zero");

	/* Enabled, but no saliency: same result */
	MTPA_computeParameters(h, 1.0e-3f, 1.0e-3f, 0.04f);
	MTPA_computeCurrentReference(h, 3.0f);
	zassert_within(MTPA_getId_ref_A(h), 0.0f, TOL, "Id without saliency");
	zassert_within(MTPA_getIq_ref_A(h), 3.0f, TOL, "Iq without saliency");
}

/* angle = acos(g - sqrt(g^2 + 1/2)) with g = k / Is */
ZTEST(realtimelib, test_mtpa_current_angle)
{
	MTPA_Obj obj = {0};
	MTPA_Handle h = MTPA_init(&obj, sizeof(obj));
	const float k = 10.0f, is = 5.0f;
	const float g = k / is;
	const float want = acosf(g - sqrtf(g * g + 0.5f));

	MTPA_computeParameters(h, 1.0e-3f, 2.0e-3f, 0.04f);
	MTPA_enable(h);

	zassert_within(MTPA_computeCurrentAngle(h, is), want, TOL, "angle %f", (double)want);
	zassert_within(MTPA_getCurrentAngle_rad(h), want, TOL, "getter");
	zassert_true(want > MATH_PI_OVER_TWO, "past 90 degrees, so Id < 0");

	/* The angle is consistent with the current reference: tan(angle) = Iq / Id */
	MTPA_computeCurrentReference(h, is);
	zassert_within(cosf(want) * is, MTPA_getId_ref_A(h), 1.0e-3f, "Id = Is cos(angle)");
}

ZTEST(realtimelib, test_mtpa_init_rejects_small_buffer)
{
	MTPA_Obj obj;

	zassert_is_null(MTPA_init(&obj, 1), "a too small buffer must be rejected");
}

/* The tables are the motor inductances scaled by a current dependent factor */
ZTEST(realtimelib, test_mtpa_tables_and_lookup)
{
	MTPA_Obj obj = {0};
	MTPA_Handle h = MTPA_init(&obj, sizeof(obj));
	const float tol = 1.0e-9f;

	zassert_within(MTPA_Ld_tableData_H[0], LS_D_H * 1.025f, tol, "Ld[0]");
	zassert_within(MTPA_Ld_tableData_H[5], LS_D_H, tol, "Ld[5]");
	zassert_within(MTPA_Ld_tableData_H[20], LS_D_H * 0.925f, tol, "Ld[20]");
	zassert_within(MTPA_Lq_tableData_H[0], LS_Q_H * 1.050f, tol, "Lq[0]");
	zassert_within(MTPA_Lq_tableData_H[5], LS_Q_H, tol, "Lq[5]");
	zassert_within(MTPA_Lq_tableData_H[20], LS_Q_H * 0.850f, tol, "Lq[20]");

	obj.deltaIs_Ld_A = 0.5f;
	obj.deltaIs_Lq_A = 0.5f;
	obj.indexMax_Ld = MTPA_LUT_INDEX_LD_MAX;
	obj.indexMax_Lq = MTPA_LUT_INDEX_LQ_MAX;

	zassert_within(MTPA_updateLs_d_withLUT(h, 2.5f), LS_D_H, tol, "d at 2.5 A");
	zassert_within(MTPA_updateLs_d_withLUT(h, 100.0f), LS_D_H * 0.925f, tol, "d clamps at the end");

	/* The q lookup must use the q table, which differs from the d table at every index */
	zassert_within(MTPA_updateLs_q_withLUT(h, 0.0f), LS_Q_H * 1.050f, tol, "q at 0 A");
	zassert_within(MTPA_updateLs_q_withLUT(h, 2.5f), LS_Q_H, tol, "q at 2.5 A");
	zassert_within(MTPA_updateLs_q_withLUT(h, 100.0f), LS_Q_H * 0.850f, tol, "q clamps at the end");
}
```

## src/test_prebuilt.c
```c
/*
 * Copyright (c) 2026 Texas Instruments Incorporated
 *
 * SPDX-License-Identifier: BSD-3-Clause
 */

#include <math.h>

#include <zephyr/ztest.h>

#include <dead_time_comp.h>
#include <est.h>
#include <esmo.h>
#include <flux_obs.h>
#include <speedfr.h>
#include <ti_tune_rs.h>
#include <vsf.h>

#define TOL 1.0e-4f

static USER_Params up;

static void fill_user_params(void)
{
	memset(&up, 0, sizeof(up));
	up.systemFreq_MHz = 200.0f;
	up.maxFrequency_Hz = 200.0f;
	up.voltage_sf = 24.0f;
	up.current_sf = 10.0f;
	up.ctrlPeriod_sec = 50.0e-6f;
	up.motor_Rs_Ohm = 0.5f;
	up.motor_Ls_d_H = 1.0e-3f;
	up.motor_Ls_q_H = 1.25e-3f;
	up.motor_ratedFlux_Wb = 0.01f;
	up.motor_numPolePairs = 4;
	up.numIsrTicksPerCtrlTick = 1;
	up.numIsrTicksPerEstTick = 1;
	up.numIsrTicksPerTrajTick = 1;
	up.numCtrlTicksPerCurrentTick = 1;
	up.numCtrlTicksPerSpeedTick = 10;
}

/* vsf: steps the PWM frequency towards the allowed range, one delta per call */
ZTEST(realtimelib, test_vsf_init_and_frequency_step)
{
	VSF_Obj obj;
	VSF_Handle vsf = VSF_init(&obj, sizeof(obj));

	zassert_not_null(vsf, "VSF_init");
	zassert_is_null(VSF_init(&obj, 1), "a too small buffer must be rejected");

	fill_user_params();
	VSF_initParams(vsf, &up);
	zassert_equal(obj.cpuFreq_Hz, 200000000U, "cpu clock");
	zassert_equal(obj.pwmFreqSet_Hz, CONFIG_TI_REALTIMELIB_VSF_PWM_FREQ_KHZ * 1000,
		      "start frequency from Kconfig");
	/* The counter is up-down, so the period is half the clock over the PWM frequency */
	zassert_equal(obj.pwmPeriod, (200000000U / 2U) / obj.pwmFreqNow_Hz, "period %u",
		      obj.pwmPeriod);
	zassert_equal(obj.state, VSF_STATE_IDLE, "idle");

	/* 50 kHz is above the 25 kHz limit: the target is clamped and one step is taken */
	VSF_computeFreqParams(vsf);
	zassert_equal(obj.pwmFreqTarget_Hz, VSF_NUM_MAX_FREQ_HZ, "target clamped to max");
	zassert_equal(obj.pwmFreqNow_Hz, 50000 - VSF_NUM_DELTA, "one step down");
	zassert_equal(obj.state, VSF_STATE_PERIOD_SET, "period update pending");

	/* While the update is pending a second call changes nothing */
	VSF_computeFreqParams(vsf);
	zassert_equal(obj.pwmFreqNow_Hz, 50000 - VSF_NUM_DELTA, "waits for the ISR");
}

ZTEST(realtimelib, test_vsf_steps_up_and_stops_at_target)
{
	VSF_Obj obj;
	VSF_Handle vsf = VSF_init(&obj, sizeof(obj));

	fill_user_params();
	VSF_initParams(vsf, &up);

	/* Below the allowed range the target is the minimum, and the step goes up */
	obj.pwmFreqSet_Hz = 1000;
	obj.pwmFreqNow_Hz = 4000;
	VSF_computeFreqParams(vsf);
	zassert_equal(obj.pwmFreqTarget_Hz, VSF_NUM_MIN_FREQ_HZ, "target clamped to min");
	zassert_equal(obj.pwmFreqNow_Hz, 4000 + VSF_NUM_DELTA, "one step up");

	/* A step larger than the distance stops at the target and sets the matching period */
	obj.state = VSF_STATE_IDLE;
	obj.pwmFreqDelta_Hz = 5000;
	VSF_computeFreqParams(vsf);
	zassert_equal(obj.pwmFreqNow_Hz, VSF_NUM_MIN_FREQ_HZ, "stops at the target");
	zassert_equal(obj.pwmPeriod, (200000000U / 2U) / VSF_NUM_MIN_FREQ_HZ, "period %u",
		      obj.pwmPeriod);

	/* Inside the range, at the target, nothing happens */
	obj.state = VSF_STATE_IDLE;
	obj.pwmFreqSet_Hz = VSF_NUM_MIN_FREQ_HZ;
	VSF_computeFreqParams(vsf);
	zassert_equal(obj.state, VSF_STATE_IDLE, "no update needed");
}

/* speedfr: speed from the angle difference, low-pass filtered */
ZTEST(realtimelib, test_speedfr_tracks_constant_speed)
{
	SPDFR_Obj obj;
	SPDFR_Handle sp = SPDFR_init(&obj, sizeof(obj));
	const float freq = 50.0f;
	float theta = 0.0f;

	zassert_not_null(sp, "SPDFR_init");
	fill_user_params();
	SPDFR_reset(sp);
	SPDFR_setParams(sp, &up);

	/* K2 = 1 / (1 + Ts 2 pi 10), K3 = (1 - K2) / (maxFreq Ts) */
	zassert_within(obj.K2, 1.0f / (1.0f + 50.0e-6f * MATH_TWO_PI * 10.0f), TOL, "K2");
	zassert_within(obj.K3, (1.0f - obj.K2) / (200.0f * 50.0e-6f), TOL, "K3");

	for (int i = 0; i < 4000; i++) {
		theta += MATH_TWO_PI * freq * 50.0e-6f;
		if (theta > MATH_PI) {
			theta -= MATH_TWO_PI;
		}
		SPDFR_run(sp, theta);
	}
	zassert_within(SPDFR_getSpeedHz(sp), freq, 0.05f, "speed %f Hz",
		       (double)SPDFR_getSpeedHz(sp));

	/* A constant angle gives zero speed again */
	for (int i = 0; i < 8000; i++) {
		SPDFR_run(sp, theta);
	}
	zassert_within(SPDFR_getSpeedHz(sp), 0.0f, 0.05f, "speed decays to zero");
}

/* esmo: the plant and scale factors follow from the motor and system data */
ZTEST(realtimelib, test_esmo_set_params)
{
	ESMO_Obj obj;
	ESMO_Handle esmo = ESMO_init(&obj, sizeof(obj));
	const float ts = 50.0e-6f;

	zassert_not_null(esmo, "ESMO_init");
	zassert_is_null(ESMO_init(&obj, 1), "a too small buffer must be rejected");

	fill_user_params();
	ESMO_resetParams(esmo);
	ESMO_setParams(esmo, &up);

	zassert_within(obj.Ts, ts, 1.0e-9f, "Ts");
	zassert_within(obj.speed_sf, 1.0f / 200.0f, 1.0e-9f, "speed scale");
	zassert_within(obj.voltage_sf, (MATH_ONE_OVER_THREE / 4096.0f) / 24.0f, 1.0e-9f,
		       "voltage scale");
	zassert_within(obj.current_sf, (1.0f / 4096.0f) / 10.0f, 1.0e-9f, "current scale");
	zassert_within(obj.Fdsmopos, 1.0f - 0.5f / 1.0e-3f * ts, TOL, "d plant %f",
		       (double)obj.Fdsmopos);
	zassert_within(obj.Fqsmopos, 1.0f - 0.5f / 1.25e-3f * ts, TOL, "q plant %f",
		       (double)obj.Fqsmopos);
	zassert_within(obj.Gdsmopos, (24.0f * ts / 10.0f) / 1.0e-3f, TOL, "d gain %f",
		       (double)obj.Gdsmopos);
	zassert_within(obj.Ke_PU, (0.01f * 200.0f * MATH_TWO_PI) / (24.0f * 4096.0f), 1.0e-7f,
		       "Ke");
	zassert_within(obj.pll_Umax, 1.0f, TOL, "pll limits");
}

/* dead_time_comp (prebuilt): disabled gives no output, enabled is limited */
ZTEST(realtimelib, test_dead_time_comp)
{
	DTC_Handle dtc = DTC_getInstance(DTC_MOTOR_1);
	DTC_InitParams_t p;
	DTC_Output_t out;

	zassert_not_null(dtc, "DTC_getInstance");
	DTC_setDefaultParams(&p);
	zassert_within(p.maxOutFactor, DTC_DEFAULT_MAX_OUT_FACTOR, TOL, "default limit");
	zassert_within(p.speedEnableLimit_Hz, DTC_DEFAULT_SPEED_ENABLE_LIMIT_HZ, TOL, "enable");
	zassert_within(p.speedDisableLimit_Hz, DTC_DEFAULT_SPEED_DISABLE_LIMIT_HZ, TOL, "disable");

	p.enableDTC = false;
	DTC_initParams(dtc, &p);
	zassert_false(DTC_isEnabled(dtc), "disabled");
	DTC_updateCoeffs(dtc, 50.0f, 50.0e-6f, 24.0f);
	DTC_run(dtc, 1.0f, 2.0f);
	DTC_getOutput(dtc, &out);
	zassert_within(out.Vd_V, 0.0f, TOL, "no output while disabled");
	zassert_within(out.Vq_V, 0.0f, TOL, "no output while disabled");

	DTC_enable(dtc);
	zassert_true(DTC_isEnabled(dtc), "enabled");
	DTC_updateGains(dtc, 1.0f, 1.0f, 0.5f, 0.5f);
	for (int i = 0; i < 3; i++) {
		DTC_updateCoeffs(dtc, 50.0f, 50.0e-6f, 24.0f);
		DTC_run(dtc, 1.0f, 2.0f);
	}
	/* The output saturates at maxOutFactor * Vdc and opposes the current */
	zassert_within(DTC_getVd(dtc), -p.maxOutFactor * 24.0f, 1.0e-3f, "Vd %f",
		       (double)DTC_getVd(dtc));
	zassert_within(DTC_getVq(dtc), -p.maxOutFactor * 24.0f, 1.0e-3f, "Vq %f",
		       (double)DTC_getVq(dtc));

	DTC_disable(dtc);
	zassert_false(DTC_isEnabled(dtc), "disabled again");
}

/* flux_obs (prebuilt): needs the tuning before the motor parameters */
ZTEST(realtimelib, test_flux_obs_parameter_checks_and_run)
{
	static uint8_t mem[256] __aligned(8);
	const size_t size = FLUX_OBS_getMemorySize();
	FLUX_OBS_Handle fo;
	const FLUX_OBS_TuningParams_t tune = {10.0f, 0.1f, 0.1f, 0.1f, 100.0f, false, false};
	const FLUX_OBS_TuningParams_t bad_tune = {0.1f, 10.0f, 0.1f, 0.1f, 100.0f, false, false};
	const FLUX_OBS_InitParams_t params = {50.0e-6f, 0.5f, 1.0e-3f, 0.01f};
	const FLUX_OBS_InitParams_t bad_params = {50.0e-6f, 0.0f, 1.0e-3f, 0.01f};
	FLUX_OBS_VoltageInput_t v = {1.0f, 0.0f};
	FLUX_OBS_CurrentInput_t c = {0.5f, 0.0f};
	FLUX_OBS_Output_t o = {0};

	zassert_true(size > 0 && size <= sizeof(mem), "size %u", (unsigned int)size);
	zassert_is_null(FLUX_OBS_init(mem, size - 1), "a too small buffer must be rejected");
	fo = FLUX_OBS_init(mem, size);
	zassert_not_null(fo, "FLUX_OBS_init");

	zassert_true(FLUX_OBS_setParams(fo, &params) < 0, "parameters before tuning");
	zassert_true(FLUX_OBS_setTuning(fo, &bad_tune) < 0, "max below min");
	zassert_equal(FLUX_OBS_setTuning(fo, &tune), 0, "tuning");
	zassert_true(FLUX_OBS_setParams(fo, &bad_params) < 0, "zero resistance");
	zassert_equal(FLUX_OBS_setParams(fo, &params), 0, "parameters");
	zassert_equal(FLUX_OBS_updateFilterParams(fo), 0, "filter");
	zassert_equal(FLUX_OBS_resetState(fo), 0, "reset");

	for (int i = 0; i < 4; i++) {
		zassert_equal(FLUX_OBS_run(fo, &v, &c, &o), 0, "run");
	}
	zassert_true(isfinite(o.angle_rad) && fabsf(o.angle_rad) <= MATH_PI, "angle %f",
		     (double)o.angle_rad);
	zassert_within(FLUX_OBS_getAngle_rad(fo), o.angle_rad, TOL, "getter matches output");
	zassert_within(FLUX_OBS_getSpeed_Hz(fo), o.speed_Hz, TOL, "speed getter");
}

/* FAST estimator (prebuilt): the object keeps the parameters it was given */
ZTEST(realtimelib, test_fast_estimator_set_params)
{
	EST_Handle e = EST_initEst(0);

	zassert_not_null(e, "EST_initEst");
	fill_user_params();
	EST_setParams(e, &up);
	zassert_within(EST_getRs_Ohm(e), 0.5f, TOL, "Rs %f", (double)EST_getRs_Ohm(e));
}

/* ti_tune (prebuilt) */
ZTEST(realtimelib, test_ti_tune_init)
{
	static uint8_t mem[512] __aligned(8);

	zassert_is_null(TiTune_Rs_init(mem, 1), "a too small buffer must be rejected");
	zassert_not_null(TiTune_Rs_init(mem, sizeof(mem)), "TiTune_Rs_init");
}
```
