## pr-preview/pr-62/docs/zephyr/contribute/style/kconfig.html
```kconfig
<!DOCTYPE html>
<html class="writer-html5" lang="en" data-content_root="../../">
<head>
  <meta charset="utf-8" /><meta name="viewport" content="width=device-width, initial-scale=1" />

  <meta name="viewport" content="width=device-width, initial-scale=1.0" />
  <title>Kconfig Style Guidelines &mdash; Zephyr Project Documentation</title>
      <link rel="stylesheet" type="text/css" href="../../_static/pygments.css?v=03e43079" />
      <link rel="stylesheet" type="text/css" href="../../_static/css/theme.css?v=9edc463e" />
      <link rel="stylesheet" type="text/css" href="../../_static/graphviz.css?v=4ae1632d" />
      <link rel="stylesheet" type="text/css" href="../../_static/doxytooltip.css?v=07852572" />
      <link rel="stylesheet" type="text/css" href="../../_static/copybutton.css?v=76b2166b" />
      <link rel="stylesheet" type="text/css" href="../../_static/togglebutton.css?v=9c3e77be" />
      <link rel="stylesheet" type="text/css" href="../../_static/css/custom.css?v=b2ece5be" />

  
    <link rel="shortcut icon" href="../../_static/favicon.png"/>
    <link rel="canonical" href="https://docs.zephyrproject.org/latest/contribute/style/kconfig.html" />
      <script src="../../_static/jquery.js?v=5d32c60e"></script>
      <script src="../../_static/_sphinx_javascript_frameworks_compat.js?v=2cd50e6c"></script>
      <script src="../../_static/documentation_options.js?v=2f20d6c1"></script>
      <script src="../../_static/doctools.js?v=fd6eb6e6"></script>
      <script src="../../_static/sphinx_highlight.js?v=6ffebe34"></script>
      <script src="../../_static/tippy/popper.min.js?v=f051b558"></script>
      <script src="../../_static/tippy/tippy-bundle.umd.min.js?v=873d6056"></script>
      <script src="../../_static/doxytooltip.js?v=ab77ca7a"></script>
      <script src="../../_static/clipboard.min.js?v=a7894cd8"></script>
      <script src="../../_static/copybutton.js?v=761fddf6"></script>
      <script src="../../_static/js/custom.js?v=1603dd89"></script>
      <script>let toggleHintShow = 'Click to show';</script>
      <script>let toggleHintHide = 'Click to hide';</script>
      <script>let toggleOpenOnPrint = 'true';</script>
      <script src="../../_static/togglebutton.js?v=b8b12719"></script>
      <script>var togglebuttonSelector = '.toggle, .admonition.dropdown';</script>
    <script src="../../_static/js/theme.js"></script>
    <link rel="index" title="Index" href="../../genindex.html" />
    <link rel="search" title="Search" href="../../search.html" />
    <link rel="next" title="Python Style Guidelines" href="python.html" />
    <link rel="prev" title="Devicetree Style Guidelines" href="devicetree.html" />
  <meta name="color-scheme" content="dark light">
  
  <noscript id="dark-mode-toggle-stylesheets">
    <link rel="stylesheet" href="../../_static/css/light.css" type="text/css" media="(prefers-color-scheme: light)"/>
    <link rel="stylesheet" href="../../_static/css/dark.css" type="text/css" media="(prefers-color-scheme: dark)"/>
  </noscript>
  <script src="../../_static/js/dark-mode-toggle-stylesheets-loader.min.js"></script>
  <script type="module" src="../../_static/js/dark-mode-toggle.min.mjs"></script>

</head>

<body class="wy-body-for-nav"> 
  <div class="wy-grid-for-nav">
    <nav data-toggle="wy-nav-shift" class="wy-nav-side">
      <div class="wy-side-scroll">
        <div class="wy-side-nav-search" >

          
          
          <a href="../../index.html">
            
              <img src="../../_static/logo.svg" class="logo" alt="Logo"/>
          </a>
<div class="search-container" role="search">
  <form id="rtd-search-form" class="wy-form" action="../../search.html" method="get">
    <input type="search" name="q" placeholder="Search docs"
           aria-label="Search docs" />
    <span id="search-se-settings-icon" class="fa fa-gear" role="button" tabindex="0"
          title="Search settings" aria-label="Search settings"
          aria-haspopup="menu" aria-controls="search-se-menu" aria-expanded="false"
          onclick="toggleSearchEngineSettingsMenu()">
    </span>
    <div id="search-se-menu" role="menu" aria-labelledby="search-se-settings-icon">
      <ul>
        <li id="search-se-menuitem-sphinx" role="menuitemradio" tabindex="-1"
            aria-label="Built-in search" onclick="switchSearchEngine('sphinx')">
          Built-in search <span class="fa fa-check"></span>
        </li>
        <li id="search-se-menuitem-google" role="menuitemradio" tabindex="-1"
            aria-label="Google search" onclick="switchSearchEngine('google')">
          Google search <span class="fa fa-check"></span>
        </li>
      </ul>
    </div>
    <input type="hidden" name="check_keywords" value="yes" />
    <input type="hidden" name="area" value="default" />
  </form>
</div>
<script>
(function () {
  var form = document.getElementById("rtd-search-form");
  var searchMenu = document.getElementById("search-se-menu");
  var isBrowsingLatest = window.location.pathname.startsWith("/latest");
  var preferenceKey = "search-se-" + (isBrowsingLatest ? "latest" : "default");
  var query = new URLSearchParams(window.location.search).get("q");

  if (query !== null) {
    form.q.value = query;
    form.q.focus();
  }

  // Load the saved search preference. Defaults to Google when browsing "/latest" documentation,
  // built-in Sphinx search otherwise.
  var engine = localStorage.getItem(preferenceKey);
  if (engine === null) {
    engine = isBrowsingLatest ? "google" : "sphinx";
  }
  setActiveSearchEngine(engine);

  setSearchEngineSettingsMenuVisibility = function (visible) {
    searchMenu.style.display = visible ? "block" : "none";
    document
      .getElementById("search-se-settings-icon")
      .setAttribute("aria-expanded", visible ? "true" : "false");
  };
  setSearchEngineSettingsMenuVisibility(false);

  window.toggleSearchEngineSettingsMenu = function () {
    isVisible = searchMenu.style.display === "block";
    setSearchEngineSettingsMenuVisibility(!isVisible);
  };

  function setActiveSearchEngine(engine) {
    if(engine === "sphinx") {
      form.action = "../../search.html";
      form.q.placeholder = "Search docs (built-in search)";
    } else {
      form.action = "../../gsearch.html";
      form.q.placeholder = "Search docs (powered by Google)";
    }

    var selectedElement = document.getElementById("search-se-menuitem-" + engine);
    var otherElement = document.getElementById(
      "search-se-menuitem-" + (engine === "sphinx" ? "google" : "sphinx")
    );

    selectedElement.classList.add("selected");
    selectedElement.setAttribute("aria-checked", "true");
    otherElement.classList.remove("selected");
    otherElement.setAttribute("aria-checked", "false");
  }

  window.switchSearchEngine = function (engine) {
    setActiveSearchEngine(engine);
    localStorage.setItem(preferenceKey, engine);
    setSearchEngineSettingsMenuVisibility(false);
    form.q.focus();
    if (form.q.value !== "") {
      form.submit();
    }
  };

  // Close the dropdown if the user clicks outside of it
  window.onclick = function (event) {
    if (!event.target.matches("#search-se-settings-icon")) {
      if (searchMenu.style.display === "block") {
        setSearchEngineSettingsMenuVisibility(false);
      }
    }
  };

  document.addEventListener("keydown", function (event) {
    if(searchMenu.style.display === "none") return;

    let menuItems = document.querySelectorAll('[role="menuitemradio"]');
    let currentIndex = Array.from(menuItems).findIndex((item) => item === document.activeElement);

    if (event.key === "ArrowDown" || event.key === "ArrowUp") {
      let nextIndex = event.key === "ArrowDown" ? currentIndex + 1 : currentIndex - 1;

      if (nextIndex >= menuItems.length) nextIndex = 0;
      if (nextIndex < 0) nextIndex = menuItems.length - 1;

      menuItems[nextIndex].focus();
      event.preventDefault();
    } else if (event.key === "Enter") {
      let activeItem = document.activeElement;
      if (activeItem && activeItem.getAttribute("role") === "menuitemradio") {
        activeItem.click();
        event.preventDefault();
      }
    }
  });
})();
</script>
        </div><div class="wy-menu wy-menu-vertical" data-spy="affix" role="navigation" aria-label="Navigation menu">
  <div data-nosnippet>
    
  <div class="rst-versions" data-toggle="rst-versions" role="note" aria-label="versions">
    <span class="rst-current-version" data-toggle="rst-current-version">
      <span class="fa fa-book"> Zephyr Project</span>
      v: latest
      <span class="fa fa-caret-down"></span>
    </span>
    <div class="rst-other-versions">
      <dl>
        <dt>Document Release Versions</dt>
        
          <dd><a href="/">latest</a></dd>
        
          <dd><a href="/4.4.0/">4.4.0</a></dd>
        
          <dd><a href="/4.3.0/">4.3.0</a></dd>
        
          <dd><a href="/3.7.0/">3.7.0 (LTS)</a></dd>
        
      </dl>
      <dl>
        <dt>Downloads</dt>
        
        <dd><a href="/latest/zephyr.pdf">PDF</a></dd>
      </dl>
      <dl>
        <dt>zephyrproject.org Links</dt>
          <dd>
            <a href="https://www.zephyrproject.org/">Project Home</a>
          </dd>
          <dd>
            <a href="https://github.com/zephyrproject-rtos/sdk-ng/releases">SDK</a>
          </dd>
          <dd>
            <a href="https://github.com/zephyrproject-rtos/zephyr/releases">Releases</a>
          </dd>
      </dl>
    </div>
  </div>
    
              <ul class="current">
<li class="toctree-l1"><a class="reference internal" href="../../introduction/index.html">Introduction</a></li>
<li class="toctree-l1"><a class="reference internal" href="../../develop/index.html">Developing with Zephyr</a></li>
<li class="toctree-l1"><a class="reference internal" href="../../kernel/index.html">Kernel</a></li>
<li class="toctree-l1"><a class="reference internal" href="../../services/index.html">OS Services</a></li>
<li class="toctree-l1"><a class="reference internal" href="../../build/index.html">Build and Configuration Systems</a></li>
<li class="toctree-l1"><a class="reference internal" href="../../connectivity/index.html">Connectivity</a></li>
<li class="toctree-l1"><a class="reference internal" href="../../hardware/index.html">Hardware Support</a></li>
<li class="toctree-l1 current"><a class="reference internal" href="../index.html">Contributing to Zephyr</a><ul class="current">
<li class="toctree-l2 current"><a class="reference internal" href="../index.html#general-guidelines">General Guidelines</a><ul class="current">
<li class="toctree-l3"><a class="reference internal" href="../guidelines.html">Contribution Guidelines</a></li>
<li class="toctree-l3"><a class="reference internal" href="../contributor_expectations.html">Contributor Expectations</a></li>
<li class="toctree-l3"><a class="reference internal" href="../reviewer_expectations.html">Reviewer Expectations</a></li>
<li class="toctree-l3"><a class="reference internal" href="../coding_guidelines/index.html">Coding Guidelines</a></li>
<li class="toctree-l3 current"><a class="reference internal" href="index.html">Coding Style Guidelines</a><ul class="current">
<li class="toctree-l4"><a class="reference internal" href="naming.html">Naming conventions</a></li>
<li class="toctree-l4"><a class="reference internal" href="code.html">C Code and General Style Guidelines</a></li>
<li class="toctree-l4"><a class="reference internal" href="doxygen.html">Doxygen Style Guidelines</a></li>
<li class="toctree-l4"><a class="reference internal" href="cmake.html">CMake Style Guidelines</a></li>
<li class="toctree-l4"><a class="reference internal" href="devicetree.html">Devicetree Style Guidelines</a></li>
<li class="toctree-l4 current"><a class="current reference internal" href="#">Kconfig Style Guidelines</a><ul>
<li class="toctree-l5"><a class="reference internal" href="#basic-formatting-rules">Basic Formatting Rules</a></li>
<li class="toctree-l5"><a class="reference internal" href="#symbol-naming-and-structure">Symbol Naming and Structure</a></li>
<li class="toctree-l5"><a class="reference internal" href="#naming-conventions">Naming Conventions</a></li>
<li class="toctree-l5"><a class="reference internal" href="#configuration-symbol-organization">Configuration Symbol Organization</a></li>
<li class="toctree-l5"><a class="reference internal" href="#file-organization">File Organization</a></li>
</ul>
</li>
<li class="toctree-l4"><a class="reference internal" href="python.html">Python Style Guidelines</a></li>
<li class="toctree-l4"><a class="reference internal" href="index.html#style-tools">Style Tools</a></li>
</ul>
</li>
<li class="toctree-l3"><a class="reference internal" href="../proposals_and_rfcs.html">Proposals and RFCs</a></li>
<li class="toctree-l3"><a class="reference internal" href="../modifying_contributions.html">Modifying Contributions made by other developers</a></li>
<li class="toctree-l3"><a class="reference internal" href="../pr_lifecycle_policy.html">Pull Request Lifecycle Policy</a></li>
</ul>
</li>
<li class="toctree-l2"><a class="reference internal" href="../index.html#documentation">Documentation</a></li>
<li class="toctree-l2"><a class="reference internal" href="../index.html#dealing-with-external-components">Dealing with external components</a></li>
<li class="toctree-l2"><a class="reference internal" href="../index.html#need-help-along-the-way">Need help along the way?</a></li>
</ul>
</li>
<li class="toctree-l1"><a class="reference internal" href="../../project/index.html">Project and Governance</a></li>
<li class="toctree-l1"><a class="reference internal" href="../../security/index.html">Security</a></li>
<li class="toctree-l1"><a class="reference internal" href="../../safety/index.html">Safety</a></li>
<li class="toctree-l1"><a class="reference internal" href="../../samples/index.html">Samples and Demos</a></li>
<li class="toctree-l1"><a class="reference internal" href="../../boards/index.html">Supported Boards and Shields</a></li>
<li class="toctree-l1"><a class="reference internal" href="../../releases/index.html">Releases</a></li>
</ul>

    
    <div class="toctree-wrapper compound">
      <p class="caption"><span class="caption-text">Reference</span></p>
      <ul>
        
        <li class="toctree-l1">
          <a class="reference internal" href="/doxygen/html/index.html">API</a>
        </li>
        
        <li class="toctree-l1">
          <a class="reference internal" href="/kconfig.html">Kconfig Options</a>
        </li>
        
        <li class="toctree-l1">
          <a class="reference internal" href="/build/dts/api/bindings.html">Devicetree Bindings</a>
        </li>
        
        <li class="toctree-l1">
          <a class="reference internal" href="/develop/manifest/index.html">West Projects</a>
        </li>
        
        <li class="toctree-l1">
          <a class="reference internal" href="/glossary.html">Glossary</a>
        </li>
        
      </ul>
    </div>
    
  </div>

        </div>
      </div>
    </nav>

    <section data-toggle="wy-nav-shift" class="wy-nav-content-wrap"><nav class="wy-nav-top" aria-label="Mobile navigation menu" >
          <i data-toggle="wy-nav-top" class="fa fa-bars"></i>
          <a href="../../index.html">Zephyr Project</a>
      </nav>

      <div class="wy-nav-content">
        <div class="rst-content">
          <div role="navigation" aria-label="Page navigation">
  <ul class="wy-breadcrumbs">
  <!-- Docs / Latest -->
  
  

  <li><a href="../../index.html">Docs / Latest</a> &raquo;</li>
  
     <li><a href="../index.html">Contributing to Zephyr</a> &raquo;</li>
  
     <li><a href="index.html">Coding Style Guidelines</a> &raquo;</li>
  
  <li>Kconfig Style Guidelines</li>


  <li class="wy-breadcrumbs-aside">
    <dark-mode-toggle id="dark-mode-toggle" appearance="three-way" permanent="true"/>
  </li>
  <li class="wy-breadcrumbs-aside">
      
      
        <a href="https://github.com/zephyrproject-rtos/zephyr/blob/main/doc/contribute/style/kconfig.rst" class="fa fa-github"> Open on GitHub</a>
      
        <a href="https://github.com/zephyrproject-rtos/zephyr/issues/new?template=001_bug_report.yml&title=doc%3A+Documentation+issue+in+%27contribute%2Fstyle%2Fkconfig%27&labels=bug%2Carea%3A+Documentation%2Carea%3A+Documentation&env=-+Page%3A+contribute%2Fstyle%2Fkconfig%0A-+Version%3A+main%0A-+SHA-1%3A+560e5f87670c05b07c8c2e88e652ed94740ea033&context=This+issue+was+reported+from+the+online+documentation+page+using+the+%27Report+an+issue%27+button." class="fa fa-bug">
          Report an issue with this page
        </a>
      
    
  </li>
  </ul>
  <hr/>
</div>
          <div role="main" class="document" itemscope="itemscope" itemtype="http://schema.org/Article">
  
  
           <div itemprop="articleBody">
             
  <section id="kconfig-style-guidelines">
<span id="kconfig-style"></span><h1>Kconfig Style Guidelines<a class="headerlink" href="#kconfig-style-guidelines" title="Link to this heading"></a></h1>
<p>This document provides style guidelines for writing Kconfig files in the Zephyr
project. Following these guidelines ensures consistency and readability across
the codebase, making it easier for developers to understand and maintain
configuration options.</p>
<p>The following sections provide guidelines with examples to illustrate
proper Kconfig formatting and naming conventions.</p>
<section id="basic-formatting-rules">
<h2>Basic Formatting Rules<a class="headerlink" href="#basic-formatting-rules" title="Link to this heading"></a></h2>
<p>When writing Kconfig files, follow these basic formatting rules:</p>
<ul class="simple">
<li><p><strong>Line length</strong>: Keep lines to 100 columns or fewer.</p></li>
<li><p><strong>Indentation</strong>: Use tabs for indentation, except for <code class="docutils literal notranslate"><span class="pre">help</span></code> entry text
which should be placed at one tab plus two extra spaces.</p></li>
<li><p><strong>Spacing</strong>: Leave a single empty line between option declarations.</p></li>
<li><p><strong>Comments</strong>: Format comments as <code class="docutils literal notranslate"><span class="pre">#</span> <span class="pre">Comment</span></code> rather than <code class="docutils literal notranslate"><span class="pre">#Comment</span></code>.</p></li>
<li><p><strong>Conditional blocks</strong>: Insert an empty line before/after each top-level
<code class="docutils literal notranslate"><span class="pre">if</span></code> and <code class="docutils literal notranslate"><span class="pre">endif</span></code> statement.</p></li>
</ul>
<p>For guidance on using statements like <code class="docutils literal notranslate"><span class="pre">select</span></code>, see
<a class="reference internal" href="../../build/kconfig/tips.html#kconfig-tips-and-tricks"><span class="std std-ref">Kconfig - Tips and Best Practices</span></a> for more information.</p>
</section>
<section id="symbol-naming-and-structure">
<h2>Symbol Naming and Structure<a class="headerlink" href="#symbol-naming-and-structure" title="Link to this heading"></a></h2>
<p>The following examples demonstrate proper Kconfig symbol naming and structure:</p>
<div class="highlight-kconfig notranslate"><div class="highlight"><pre><span></span><span class="c1"># Symbol to enable/disable the feature (&quot;enabling symbol&quot;)</span>
<span class="k">config</span><span class="w"> </span>ADC_AD405X
<span class="w">	</span><span class="nb">bool</span><span class="w"> </span><span class="s2">&quot;AD405X ADC driver&quot;</span>
<span class="w">	</span><span class="k">depends on</span><span class="w"> </span>DT_HAS_ADI_AD4052_ADC_ENABLED<span class="w"> </span><span class="o">||</span><span class="w"> </span>DT_HAS_ADI_AD4050_ADC_ENABLED
<span class="w">	</span><span class="k">select</span><span class="w"> </span>SPI
<span class="w">	</span><span class="k">default</span><span class="w"> </span>y
<span class="w">	</span><span class="k">help</span>
<span class="sd">	  Enable ADC driver for AD405X.</span>
</pre></div>
</div>
<div class="highlight-kconfig notranslate"><div class="highlight"><pre><span></span><span class="c1"># Symbol to enable/disable the feature (&quot;enabling symbol&quot;)</span>
<span class="k">menuconfig</span><span class="w"> </span>ADC_AD4114
<span class="w">	</span><span class="nb">bool</span><span class="w"> </span><span class="s2">&quot;AD4114 ADC driver&quot;</span>
<span class="w">	</span><span class="k">depends on</span><span class="w"> </span>DT_HAS_ADI_AD4114_ADC_ENABLED
<span class="w">	</span><span class="k">select</span><span class="w"> </span>SPI
<span class="w">	</span><span class="k">default</span><span class="w"> </span>y
<span class="w">	</span><span class="k">help</span>
<span class="sd">	  Enable the AD4114 ADC driver.</span>

<span class="k">if</span><span class="w"> </span>ADC_AD4114

<span class="c1"># Symbol to configure the behavior of the feature (&quot;config symbol&quot;)</span>
<span class="k">config</span><span class="w"> </span>ADC_AD4114_ACQUISITION_THREAD_STACK_SIZE
<span class="w">	</span><span class="nb">int</span><span class="w"> </span><span class="s2">&quot;Stack size for the data acquisition thread&quot;</span>
<span class="w">	</span><span class="k">default</span><span class="w"> </span><span class="mi">512</span>
<span class="w">	</span><span class="k">help</span>
<span class="sd">	  Size of the stack used for the internal data acquisition</span>
<span class="sd">	  thread.</span>

<span class="c1"># Symbol to configure the behavior of the feature (&quot;config symbol&quot;)</span>
<span class="k">config</span><span class="w"> </span>ADC_AD4114_ACQUISITION_THREAD_PRIO
<span class="w">	</span><span class="nb">int</span><span class="w"> </span><span class="s2">&quot;Priority for the data acquisition thread&quot;</span>
<span class="w">	</span><span class="k">default</span><span class="w"> </span><span class="mi">0</span>
<span class="w">	</span><span class="k">help</span>
<span class="sd">	  Priority level for the internal ADC data acquisition thread.</span>

<span class="k">endif</span><span class="w"> </span><span class="c1"># ADC_AD4114</span>
</pre></div>
</div>
</section>
<section id="naming-conventions">
<h2>Naming Conventions<a class="headerlink" href="#naming-conventions" title="Link to this heading"></a></h2>
<ul>
<li><p>As a general rule, symbols concerning the same component should be distinct
from other symbols. This can usually be accomplished by using a common
prefix. This prefix can be a simple keyword or, as in the case for drivers,
several keywords for more precision.</p></li>
<li><p>A common prefix usually indicates the subsystem or component the symbol
belongs to.</p></li>
<li><p>An enabling symbol name should consist of keywords to provide the context
of the symbol in a scope from most general to most specific
(e.g. <em>Driver Type</em> -&gt; <em>Driver Name</em>).</p></li>
<li><p>The prompt for an enabling symbol should use the same logic as the symbol
name itself but use the keywords in reversed order.</p>
<blockquote>
<div><ul class="simple">
<li><p>Adhering to this style makes searching for symbols easier in the UI
because one can filter by a scope keyword.</p></li>
</ul>
</div></blockquote>
</li>
<li><p>When the enabling symbol is dependent on a devicetree node, consider
depending on the <a class="reference internal" href="../../build/dts/dt-vs-kconfig.html#auto-dts-kconfig"><span class="std std-ref">automatically created</span></a>
<code class="docutils literal notranslate"><span class="pre">DT_HAS_&lt;node&gt;_ENABLED</span></code> symbol.</p></li>
<li><p>When building complex expressions based on devicetree node compatibles,
use the <a class="reference internal" href="../../build/dts/dt-vs-kconfig.html#auto-dts-kconfig"><span class="std std-ref">automatically defined</span></a>
<code class="samp docutils literal notranslate"><span class="pre">DT_COMPAT_</span><em><span class="pre">VND_DEVICE</span></em></code> instead of defining a variable equal to
<code class="samp docutils literal notranslate"><em><span class="pre">vnd,device</span></em></code> manually.</p></li>
</ul>
<p>The specific formats by subtree:</p>
<ul class="simple">
<li><p><strong>Drivers (/drivers)</strong>: Use the format <code class="docutils literal notranslate"><span class="pre">{Driver</span> <span class="pre">Type}_{Driver</span> <span class="pre">Name}</span></code> for
symbols and <code class="docutils literal notranslate"><span class="pre">{Driver</span> <span class="pre">Name}</span> <span class="pre">{Driver</span> <span class="pre">Type}</span> <span class="pre">driver</span></code> for prompts.</p></li>
<li><p><strong>Sensors (/drivers/sensors)</strong>: Use the format <code class="docutils literal notranslate"><span class="pre">SENSOR_{Sensor</span> <span class="pre">Name}</span></code> for symbols
and <code class="docutils literal notranslate"><span class="pre">{Sensor</span> <span class="pre">Name}</span> <span class="pre">{Sensor</span> <span class="pre">Type}</span> <span class="pre">sensor</span> <span class="pre">driver</span></code> for prompts.</p></li>
<li><p><strong>Architecture (/arch)</strong>: Many symbols are shared across architectures. Before
creating new symbols, check if similar ones already exist in other
architectures.</p></li>
<li><p><strong>Samples (/samples)</strong>: Use <code class="docutils literal notranslate"><span class="pre">SAMPLE_</span></code> for symbols, this is to prevent conflicts with external
modules.</p></li>
<li><p><strong>Tests (/tests)</strong>: Use <code class="docutils literal notranslate"><span class="pre">TEST_</span></code> for symbols, this is to prevent conflicts with external
modules.</p></li>
<li><p><strong>Boards (/boards)</strong>: Use <code class="docutils literal notranslate"><span class="pre">BOARD_</span></code> for symbols.</p></li>
<li><p><strong>SoCs (/soc)</strong>: Use the most appropriate base for symbols: <code class="docutils literal notranslate"><span class="pre">SOC_FAMILY_{SoC</span> <span class="pre">family}_</span></code> if it
relates to a whole SoC family, <code class="docutils literal notranslate"><span class="pre">SOC_SERIES_{SoC</span> <span class="pre">series}_</span></code> if it relates to a whole SoC series,
or <code class="docutils literal notranslate"><span class="pre">SOC_{SoC}_</span></code> if it relates to a specific SoC - see <a class="reference internal" href="../../hardware/porting/soc_porting.html#soc-porting-guide"><span class="std std-ref">SoC Porting Guide</span></a> for details on
these terms and where they must originate from. This is to prevent conflicts with other vendors
and external modules.</p></li>
</ul>
<section id="examples">
<h3>Examples<a class="headerlink" href="#examples" title="Link to this heading"></a></h3>
<div class="admonition note">
<p class="admonition-title">Note</p>
<p>The following examples only show the symbol and prompt lines for brevity.</p>
</div>
<p><strong>Driver Examples:</strong></p>
<div class="highlight-kconfig notranslate"><div class="highlight"><pre><span></span><span class="k">config</span><span class="w"> </span>ADC_AD405X
<span class="w">	</span><span class="nb">bool</span><span class="w"> </span><span class="s2">&quot;AD405X ADC driver&quot;</span>

<span class="k">config</span><span class="w"> </span>CAN_MAX32
<span class="w">	</span><span class="nb">bool</span><span class="w"> </span><span class="s2">&quot;MAX32 CAN driver&quot;</span>

<span class="k">config</span><span class="w"> </span>I2C_EMUL
<span class="w">	</span><span class="nb">bool</span><span class="w"> </span><span class="s2">&quot;I2C emulator driver&quot;</span>
</pre></div>
</div>
<p><strong>Sensor Examples:</strong></p>
<div class="highlight-kconfig notranslate"><div class="highlight"><pre><span></span><span class="k">config</span><span class="w"> </span>SENSOR_BMP581
<span class="w">	</span><span class="nb">bool</span><span class="w"> </span><span class="s2">&quot;BMP581 barometric pressure sensor driver&quot;</span>

<span class="k">config</span><span class="w"> </span>SENSOR_TMP007
<span class="w">	</span><span class="nb">bool</span><span class="w"> </span><span class="s2">&quot;TMP007 infrared thermopile sensor driver&quot;</span>

<span class="k">config</span><span class="w"> </span>SENSOR_LM75
<span class="w">	</span><span class="nb">bool</span><span class="w"> </span><span class="s2">&quot;LM75 temperature sensor driver&quot;</span>
</pre></div>
</div>
<p><strong>Sample examples:</strong></p>
<div class="highlight-kconfig notranslate"><div class="highlight"><pre><span></span><span class="k">config</span><span class="w"> </span>SAMPLE_LOCK
<span class="w">	</span><span class="nb">bool</span><span class="w"> </span><span class="s2">&quot;Locking feature&quot;</span>

<span class="k">config</span><span class="w"> </span>SAMPLE_TEMPERATURE_READINGS
<span class="w">	</span><span class="nb">bool</span><span class="w"> </span><span class="s2">&quot;Fetch readings from temperature sensor&quot;</span>
</pre></div>
</div>
<p><strong>Test examples:</strong></p>
<div class="highlight-kconfig notranslate"><div class="highlight"><pre><span></span><span class="k">config</span><span class="w"> </span>TEST_ITERATIONS
<span class="w">	</span><span class="nb">int</span><span class="w"> </span><span class="s2">&quot;Number of times test should run&quot;</span>
<span class="w">	</span><span class="k">default</span><span class="w"> </span><span class="mi">3</span>
</pre></div>
</div>
<p><strong>SoC examples:</strong></p>
<div class="highlight-kconfig notranslate"><div class="highlight"><pre><span></span><span class="c1"># This assumes the following soc.yml file:</span>
<span class="c1"># family:</span>
<span class="c1">#   - name: alpha</span>
<span class="c1">#     series:</span>
<span class="c1">#       - name: foxtrot</span>
<span class="c1">#         socs:</span>
<span class="c1">#           - name: charlie</span>

<span class="k">config</span><span class="w"> </span>SOC_FAMILY_ALPHA_JTAG_LOCK
<span class="w">	</span><span class="nb">bool</span><span class="w"> </span><span class="s2">&quot;Lock JTAG access&quot;</span>

<span class="k">config</span><span class="w"> </span>SOC_SERIES_FOXTROT_EMULATE_POWER_OFF
<span class="w">	</span><span class="nb">bool</span><span class="w"> </span><span class="s2">&quot;Emulate power off mode&quot;</span>

<span class="k">config</span><span class="w"> </span>SOC_CHARLIE_IMAGE_HEADER
<span class="w">	</span><span class="nb">bool</span><span class="w"> </span><span class="s2">&quot;Include image header&quot;</span>
</pre></div>
</div>
</section>
</section>
<section id="configuration-symbol-organization">
<h2>Configuration Symbol Organization<a class="headerlink" href="#configuration-symbol-organization" title="Link to this heading"></a></h2>
<p>When a feature uses config symbols to configure its behavior:</p>
<ul class="simple">
<li><p>Use <code class="docutils literal notranslate"><span class="pre">menuconfig</span></code> instead of <code class="docutils literal notranslate"><span class="pre">config</span></code> to define the enabling feature
(even when the config symbol has no prompt).</p></li>
<li><p>Encapsulate the config symbols in an <code class="docutils literal notranslate"><span class="pre">if</span></code> statement to declare their
dependency on the enabling symbol (this automatically groups these
symbols under the enabling symbol in the UI).</p></li>
<li><p>Prefix the config symbol with the enabling symbol’s name for scope and
context.</p></li>
<li><p>In the prompt of the config symbol, describe what the symbol configures
without repeating the scope keywords, because the grouping in the UI
provides this context.</p></li>
</ul>
</section>
<section id="file-organization">
<h2>File Organization<a class="headerlink" href="#file-organization" title="Link to this heading"></a></h2>
<p>When organizing Kconfig files:</p>
<ul class="simple">
<li><p>Keep the Kconfig file close to the source files it configures.</p></li>
<li><p>When dealing with large Kconfig files (e.g. with many config symbols),
consider grouping (some of) them into a separate file and import it using the
<code class="docutils literal notranslate"><span class="pre">source</span></code> directive to improve readability.</p></li>
</ul>
</section>
</section>


           </div>
          </div>

          <footer>

  <hr/>

  <div role="contentinfo">
<p>
  &#169; Copyright 2015-2026 Zephyr Project members and individual contributors.
  <div class="lastupdated">
    Last generated: Nov 09, 2026.
    Last source update: Oct 29, 2026.
  </div></p>

  </div>

   

</footer>
        </div>
      </div>
    </section>
  </div>
  <script>
      jQuery(function () {
          SphinxRtdTheme.Navigation.enable(true);
      });
  </script> 

</body>
</html>
```
