## samples/basic/blinky/sample.yaml
```yaml
sample:
  name: TI Blinky
  description: Blink an LED on TI LaunchPad boards.
tests:
  sample.blinky:
    tags:
      - LED
      - GPIO
    harness: console
    harness_config:
      type: one_line
      regex:
        - "Booting Zephyr OS"
    platform_allow:
      - lp_mspm0g3507
      - lp_mspm0g3519
      - lp_mspm0l2228
    integration_platforms:
      - lp_mspm0g3519
```

## samples/drivers/uart/echo_bot/sample.yaml
```yaml
sample:
  name: TI UART Echo
  description: Echo characters received over UART on TI LaunchPad boards.
tests:
  sample.uart_echo:
    tags:
      - UART
    harness: console
    harness_config:
      type: one_line
      regex:
        - "UART echo ready"
    platform_allow:
      - lp_mspm0g3507
      - lp_mspm0g3519
      - lp_mspm0l2228
    integration_platforms:
      - lp_mspm0g3519
```

## samples/hello_world/sample.yaml
```yaml
sample:
  name: TI Hello World
  description: Hello World sample for TI LaunchPad boards.
tests:
  sample.basic.helloworld:
    tags:
      - introduction
    harness: console
    harness_config:
      type: one_line
      regex:
        - "Hello World! (.*)"
    platform_allow:
      - lp_mspm0g3507
      - lp_mspm0g3519
      - lp_mspm0l2228
```

## tests/drivers/dma/mspm0_extended_modes/Kconfig
```kconfig
# SPDX-FileCopyrightText: 2026 Texas Instruments Incorporated
# SPDX-License-Identifier: LicenseRef-TI-TFL

mainmenu "MSPM0 DMA Extended Modes Test"

config DMA_XFER_SIZE
	int "Number of bytes to transfer"
	default 4096

source "Kconfig.zephyr"
```

## tests/lib/mathlib/fastrts_tmu/testcase.yaml
```yaml
# SPDX-FileCopyrightText: 2026 Texas Instruments Incorporated
# SPDX-License-Identifier: LicenseRef-TI-TFL

tests:
  lib.mathlib.fastrts_tmu:
    tags:
      - lib
      - mathlib
    platform_allow:
      - lp_am13e230
    harness: ztest
```

## tests/lib/mathlib/fastrts_tmu_perf/testcase.yaml
```yaml
# SPDX-FileCopyrightText: 2026 Texas Instruments Incorporated
# SPDX-License-Identifier: LicenseRef-TI-TFL

tests:
  lib.mathlib.fastrts_tmu_perf:
    tags:
      - lib
      - mathlib
    platform_allow:
      - lp_am13e230
    harness: ztest
```

## tests/lib/realtimelib/testcase.yaml
```yaml
# SPDX-FileCopyrightText: 2026 Texas Instruments Incorporated
# SPDX-License-Identifier: LicenseRef-TI-TFL

tests:
  lib.realtimelib:
    tags:
      - lib
      - realtimelib
    platform_allow:
      - lp_am13e230
    harness: ztest
```

## west.yml
```yaml
#
# Copyright (c) 2026 Texas Instruments Incorporated
#
# SPDX-License-Identifier: BSD-3-Clause
#
# The projects list below is a hand-picked set of TI-relevant entries.
manifest:
  version: "1.2"
  defaults:
    remote: zephyrproject
  remotes:
  - name: zephyrproject
    url-base: https://github.com/zephyrproject-rtos
  - name: TexasInstruments
    url-base: https://github.com/TexasInstruments

  projects:
  - name: hal_ti
    remote: TexasInstruments
    path: modules/hal/ti
    revision: v4.4.0-ti-01.00.00.02
  - name: trusted-firmware-a
    remote: TexasInstruments
    repo-path: arm-trusted-firmware
    path: modules/tee/tf-a/trusted-firmware-a
    revision: 12.01.00.05
  - name: zephyr
    remote: TexasInstruments
    path: zephyr
    revision: v4.4.0-ti-01.00.00.02
    import:
      name-allowlist:
      - cmsis
      - cmsis_6
      - cmsis-dsp
      - cmsis-nn
      - fatfs
      - liblc3
      - libmetal
      - libsbc
      - littlefs
      - lvgl
      - mbedtls
      - mipi-sys-t
      - mldsa-native
      - mcuboot
      - net-tools
      - open-amp
      - openthread
      - picolibc
      - tf-psa-crypto
      - trusted-firmware-m
      - zcbor
  self:
    path: ti-zephyr
    west-commands: scripts/west-commands.yml
```
