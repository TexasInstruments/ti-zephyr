## CMakeLists.txt
```
#
# SPDX-FileCopyrightText: 2026 Texas Instruments Incorporated
#
# SPDX-License-Identifier: LicenseRef-TI-TFL
#

cmake_minimum_required(VERSION 3.20.0)
find_package(Zephyr REQUIRED HINTS $ENV{ZEPHYR_BASE})
project(simple_gui_demo)

target_sources(app PRIVATE src/main.c)
target_sources_ifdef(CONFIG_SAMPLE_SIMPLE_GUI_DEMO_COUNTERS app PRIVATE src/counters.c)
```

## Kconfig
```
#
# SPDX-FileCopyrightText: 2026 Texas Instruments Incorporated
#
# SPDX-License-Identifier: LicenseRef-TI-TFL
#

mainmenu "Simple GUI demo application"

menuconfig SAMPLE_SIMPLE_GUI_DEMO_COUNTERS
	bool "Periodic counter demo mode"
	default y
	help
	  SW1/SW2 bump an 8-bit and a 16-bit counter on press; a periodic
	  timer bumps a 32-bit counter and a Q8 fixed-point counter.

if SAMPLE_SIMPLE_GUI_DEMO_COUNTERS

config SAMPLE_SIMPLE_GUI_DEMO_COUNTERS_PERIOD_MS
	int "Counter update period (ms)"
	default 500
	range 1 60000
	help
	  How often the 32-bit and Q8 counters update, and how often all
	  four counters are sent to the GUI.

config SAMPLE_SIMPLE_GUI_DEMO_COUNTERS_U8_STEP
	int "8-bit counter step per SW1 press"
	default 50
	range 1 255

config SAMPLE_SIMPLE_GUI_DEMO_COUNTERS_U16_STEP
	int "16-bit counter step per SW2 press"
	default 5000
	range 1 65535

config SAMPLE_SIMPLE_GUI_DEMO_COUNTERS_U32_STEP
	int "32-bit counter step per timer tick"
	default 10000

config SAMPLE_SIMPLE_GUI_DEMO_COUNTERS_Q8_DEFAULT_INCREMENT
	int "Default Q8 counter increment per timer tick (raw Q8 units, 256 = 1.0)"
	default 0
	help
	  Overridable at runtime via the "u16Data" RX command
	  (counters_set_increment()). This is only the value sent/used
	  before the GUI ever sets one.

endif # SAMPLE_SIMPLE_GUI_DEMO_COUNTERS

source "Kconfig.zephyr"
```

## sample.yaml
```
sample:
  name: Simple GUI demo
  description: Minimal reference for the GUI Composer module -- counters, a
    switch and a slider exchanged with the GUI over UART, no sensors.
tests:
  sample.gui_composer.simple_gui_demo.msgpack:
    tags:
      - gui_composer
    platform_allow:
      - lp_mspm0g3507
      - lp_mspm0g3519
      - lp_mspm0l2228
    integration_platforms:
      - lp_mspm0g3507
  sample.gui_composer.simple_gui_demo.json:
    tags:
      - gui_composer
    extra_configs:
      - CONFIG_GUI_COMPOSER_PROTOCOL_JSON=y
      - CONFIG_GUI_COMPOSER_PROTOCOL_MSGPACK=n
    platform_allow:
      - lp_mspm0g3507
      - lp_mspm0g3519
      - lp_mspm0l2228
    integration_platforms:
      - lp_mspm0g3507
```

## prj.conf
```kconfig
CONFIG_GUI_COMPOSER=y
CONFIG_GUI_COMPOSER_PROTOCOL_MSGPACK=y
CONFIG_GPIO=y
CONFIG_PRINTK=y
```

## boards/lp_mspm0g3507.conf
```kconfig
#
# SPDX-FileCopyrightText: 2026 Texas Instruments Incorporated
#
# SPDX-License-Identifier: LicenseRef-TI-TFL
#
CONFIG_CONSOLE=n
CONFIG_UART_CONSOLE=n
```

## boards/lp_mspm0g3507.overlay
```dts
/*
 * SPDX-FileCopyrightText: 2026 Texas Instruments Incorporated
 *
 * SPDX-License-Identifier: LicenseRef-TI-TFL
 */
#include <zephyr/dt-bindings/gpio/gpio.h>

&uart0 {
	rx-fifo-threshold = <0>;
};

/ {
	chosen {
		zephyr,gui-composer-uart = &uart0;
	};

	aliases {
		sw0 = &btn1;
		sw1 = &btn0;
	};
};
```

## boards/lp_mspm0g3519.overlay
```dts
/*
 * SPDX-FileCopyrightText: 2026 Texas Instruments Incorporated
 *
 * SPDX-License-Identifier: LicenseRef-TI-TFL
 */
#include <zephyr/dt-bindings/gpio/gpio.h>

&uart0 {
	rx-fifo-threshold = <0>;
};

/ {
	chosen {
		zephyr,gui-composer-uart = &uart0;
	};

	aliases {
		sw0 = &btn0;
		sw1 = &btn1;
	};
};
```

## boards/lp_mspm0l2228.overlay
```dts
/*
 * Copyright (c) 2026 Texas Instruments Incorporated
 *
 * SPDX-License-Identifier: BSD-3-Clause
 */
#include <zephyr/dt-bindings/gpio/gpio.h>

&uart0 {
	rx-fifo-threshold = <0>;
};

/ {
	chosen {
		zephyr,gui-composer-uart = &uart0;
	};

	aliases {
		sw0 = &btn0;
		sw1 = &btn1;
	};
};
```

## src/main.c
```c
/*
 * SPDX-FileCopyrightText: 2026 Texas Instruments Incorporated
 *
 * SPDX-License-Identifier: LicenseRef-TI-TFL
 */
#include <stdio.h>

#include <gui_composer/gui_composer.h>
#include <gui_composer/transport.h>

#include <zephyr/sys/util.h>
#include <zephyr/drivers/gpio.h>

#if defined(CONFIG_SAMPLE_SIMPLE_GUI_DEMO_COUNTERS)
#include "counters.h"
#endif

static const struct gpio_dt_spec led = GPIO_DT_SPEC_GET(DT_ALIAS(led0), gpios);

static void on_enable(gui_rx_value_t value)
{
	bool enable = guicomm_read_bool(value);
	int ret = gpio_pin_set_dt(&led, enable);

	if (ret != 0) {
		printf("gpio_pin_set_dt failed: %d\n", ret);
	}
#if defined(CONFIG_SAMPLE_SIMPLE_GUI_DEMO_COUNTERS)
	counters_set_enable(enable);
#endif
}

#if defined(CONFIG_SAMPLE_SIMPLE_GUI_DEMO_COUNTERS)
static void on_u16_data(gui_rx_value_t value)
{
	counters_set_increment(guicomm_read_uint16(value));
}
#endif

static const gui_rx_cmd_t rx_cmds[] = {
	{"bEnable", GUI_RX_BOOL, on_enable},
#if defined(CONFIG_SAMPLE_SIMPLE_GUI_DEMO_COUNTERS)
	{"u16Data", GUI_RX_NUMBER, on_u16_data},
#endif
};

int main(void)
{
	printf("\n[simple_gui_demo] boot\n");

	if (!gpio_is_ready_dt(&led)) {
		printf("led0 gpio not ready\n");
	}

	int ret = gpio_pin_configure_dt(&led, GPIO_OUTPUT_INACTIVE);

	if (ret != 0) {
		printf("gpio_pin_configure_dt failed: %d\n", ret);
	}

	gui_composer_transport_init();
	gui_init();
	gui_init_rx_cmd(rx_cmds, ARRAY_SIZE(rx_cmds));

	guicomm_send_bool("bEnable", 7, false);
#if defined(CONFIG_SAMPLE_SIMPLE_GUI_DEMO_COUNTERS)
	counters_init();
#endif

	return 0;
}
```

## src/counters.c
```c
/*
 * SPDX-FileCopyrightText: 2026 Texas Instruments Incorporated
 *
 * SPDX-License-Identifier: LicenseRef-TI-TFL
 */
#include <stdio.h>

#include "counters.h"
#include <gui_composer/gui_composer.h>

#include <zephyr/drivers/gpio.h>
#include <zephyr/kernel.h>

#define Q8_ONE 256
#define Q8_MAX (100 * Q8_ONE)

static const struct gpio_dt_spec sw1 = GPIO_DT_SPEC_GET(DT_ALIAS(sw0), gpios);
static const struct gpio_dt_spec sw2 = GPIO_DT_SPEC_GET(DT_ALIAS(sw1), gpios);
static struct gpio_callback sw1_cb;
static struct gpio_callback sw2_cb;

static uint8_t u8_counter = CONFIG_SAMPLE_SIMPLE_GUI_DEMO_COUNTERS_U8_STEP;
static uint16_t u16_counter = CONFIG_SAMPLE_SIMPLE_GUI_DEMO_COUNTERS_U16_STEP;
static uint32_t u32_counter = CONFIG_SAMPLE_SIMPLE_GUI_DEMO_COUNTERS_U32_STEP;
static int16_t q8_counter = Q8_ONE / 2;
static int16_t q8_increment = CONFIG_SAMPLE_SIMPLE_GUI_DEMO_COUNTERS_Q8_DEFAULT_INCREMENT;
static bool q8_counter_enabled;

static struct k_work send_work;

static void timer_expired(struct k_timer *timer)
{
	ARG_UNUSED(timer);

	u32_counter += CONFIG_SAMPLE_SIMPLE_GUI_DEMO_COUNTERS_U32_STEP;
	if (q8_counter_enabled) {
		q8_counter += q8_increment;
		if (q8_counter > Q8_MAX) {
			q8_counter = 0;
		}
	}

	k_work_submit(&send_work);
}

K_TIMER_DEFINE(counters_timer, timer_expired, NULL);

static void send_work_handler(struct k_work *work)
{
	ARG_UNUSED(work);

	guicomm_send_uint8("c1", 2, u8_counter);
	guicomm_send_uint16("c2", 2, u16_counter);
	guicomm_send_uint32("c3", 2, u32_counter);
	if (q8_counter_enabled) {
		guicomm_send_int16("c4", 2, q8_counter);
	}
}

static void sw1_pressed(const struct device *dev, struct gpio_callback *cb, uint32_t pins)
{
	ARG_UNUSED(dev);
	ARG_UNUSED(cb);
	ARG_UNUSED(pins);

	u16_counter += CONFIG_SAMPLE_SIMPLE_GUI_DEMO_COUNTERS_U16_STEP;
}

static void sw2_pressed(const struct device *dev, struct gpio_callback *cb, uint32_t pins)
{
	ARG_UNUSED(dev);
	ARG_UNUSED(cb);
	ARG_UNUSED(pins);

	u8_counter += CONFIG_SAMPLE_SIMPLE_GUI_DEMO_COUNTERS_U8_STEP;
}

void counters_set_enable(bool enable)
{
	q8_counter_enabled = enable;
}

void counters_set_increment(uint16_t increment)
{
	q8_increment = (int16_t)increment;
}

void counters_init(void)
{
	int ret = gpio_pin_configure_dt(&sw1, GPIO_INPUT);

	if (ret != 0) {
		printf("sw1 gpio_pin_configure_dt failed: %d\n", ret);
	}
	ret = gpio_pin_interrupt_configure_dt(&sw1, GPIO_INT_EDGE_TO_ACTIVE);
	if (ret != 0) {
		printf("sw1 gpio_pin_interrupt_configure_dt failed: %d\n", ret);
	}
	gpio_init_callback(&sw1_cb, sw1_pressed, BIT(sw1.pin));
	ret = gpio_add_callback(sw1.port, &sw1_cb);
	if (ret != 0) {
		printf("sw1 gpio_add_callback failed: %d\n", ret);
	}

	ret = gpio_pin_configure_dt(&sw2, GPIO_INPUT);
	if (ret != 0) {
		printf("sw2 gpio_pin_configure_dt failed: %d\n", ret);
	}
	ret = gpio_pin_interrupt_configure_dt(&sw2, GPIO_INT_EDGE_TO_ACTIVE);
	if (ret != 0) {
		printf("sw2 gpio_pin_interrupt_configure_dt failed: %d\n", ret);
	}
	gpio_init_callback(&sw2_cb, sw2_pressed, BIT(sw2.pin));
	ret = gpio_add_callback(sw2.port, &sw2_cb);
	if (ret != 0) {
		printf("sw2 gpio_add_callback failed: %d\n", ret);
	}

	guicomm_send_uint8("c1", 2, u8_counter);
	guicomm_send_uint16("c2", 2, u16_counter);
	guicomm_send_uint32("c3", 2, u32_counter);
	guicomm_send_int16("c4", 2, q8_counter);
	guicomm_send_int16("u16Data", 7, q8_increment);

	k_work_init(&send_work, send_work_handler);
	k_timer_start(&counters_timer,
		      K_MSEC(CONFIG_SAMPLE_SIMPLE_GUI_DEMO_COUNTERS_PERIOD_MS),
		      K_MSEC(CONFIG_SAMPLE_SIMPLE_GUI_DEMO_COUNTERS_PERIOD_MS));
}
```

## src/counters.h
```c
/*
 * SPDX-FileCopyrightText: 2026 Texas Instruments Incorporated
 *
 * SPDX-License-Identifier: LicenseRef-TI-TFL
 */
#ifndef SAMPLE_SIMPLE_GUI_DEMO_COUNTERS_H_
#define SAMPLE_SIMPLE_GUI_DEMO_COUNTERS_H_

#include <stdbool.h>
#include <stdint.h>

void counters_init(void);

void counters_set_enable(bool enable);

void counters_set_increment(uint16_t increment);

#endif /* SAMPLE_SIMPLE_GUI_DEMO_COUNTERS_H_ */
```
