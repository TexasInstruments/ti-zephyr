## CMakeLists.txt
```
# SPDX-FileCopyrightText: 2026 Texas Instruments Incorporated
# SPDX-License-Identifier: LicenseRef-TI-TFL

cmake_minimum_required(VERSION 3.20.0)

find_package(Zephyr REQUIRED HINTS $ENV{ZEPHYR_BASE})
project(motor_control_app)

set(UI_DIR ${CMAKE_CURRENT_SOURCE_DIR}/ui)

include(${UI_DIR}/file_list_gen.cmake)
include(${UI_DIR}/user_config.cmake)

target_sources(app PRIVATE
    src/main.c
    ${LV_EDITOR_PROJECT_SOURCES}
)

target_include_directories(app PRIVATE ${UI_DIR})
target_compile_definitions(app PRIVATE LV_LVGL_H_INCLUDE_SIMPLE)
```

## sample.yaml
```
sample:
  name: TI Motor Control LVGL UI
  description: >
    Four-screen LVGL motor-control UI with Waveshare 3.5" RPi LCD (F) display shield.
tests:
  application.motor_control_app:
    tags:
      - lvgl
      - display
      - gui
    harness: none
    extra_args: SHIELD=waveshare_3_5_rpi_lcd_f
    platform_allow:
      - lp_am13e230
```

## prj.conf
```kconfig
# SPDX-FileCopyrightText: 2026 Texas Instruments Incorporated
# SPDX-License-Identifier: LicenseRef-TI-TFL

CONFIG_DISPLAY=y
CONFIG_LVGL=y
CONFIG_INPUT=y

CONFIG_HEAP_MEM_POOL_SIZE=4096
CONFIG_MAIN_STACK_SIZE=8192

# LVGL
CONFIG_LV_COLOR_DEPTH_16=y
CONFIG_LV_USE_OBSERVER=y
CONFIG_LV_USE_THEME_SIMPLE=y
CONFIG_LV_USE_LABEL=y
CONFIG_LV_USE_IMAGE=y
CONFIG_LV_USE_BUTTON=y
CONFIG_LV_USE_ROLLER=y
CONFIG_LV_USE_CHART=y
CONFIG_LV_USE_TABLE=y
CONFIG_LV_USE_CHECKBOX=y
CONFIG_LV_FONT_MONTSERRAT_14=y
CONFIG_LV_USE_OBJ_NAME=y
CONFIG_LV_Z_POINTER_INPUT=y
CONFIG_LV_Z_POINTER_INPUT_MSGQ_COUNT=128
```

## boards/lp_am13e230.conf
```kconfig
# SPDX-FileCopyrightText: 2026 Texas Instruments Incorporated
# SPDX-License-Identifier: LicenseRef-TI-TFL


CONFIG_AM13E_SRAM_UNIFIED=y

CONFIG_LV_Z_VDB_SIZE=5
CONFIG_LV_Z_MEM_POOL_SIZE=65536
CONFIG_LV_Z_DOUBLE_VDB=y
CONFIG_LV_Z_FLUSH_THREAD=y
CONFIG_LV_Z_FLUSH_THREAD_STACK_SIZE=2048
CONFIG_LV_Z_FLUSH_THREAD_PRIORITY=-1
```

## boards/lp_am13e230.overlay
```dts
/*
 * SPDX-FileCopyrightText: 2026 Texas Instruments Incorporated
 *
 * SPDX-License-Identifier: LicenseRef-TI-TFL
 */

&sram0_1_2 {
	reg = <0x20000000 DT_SIZE_K(128)>;
};
```

## src/main.c
```c
/*
 * SPDX-FileCopyrightText: 2026 Texas Instruments Incorporated
 *
 * SPDX-License-Identifier: LicenseRef-TI-TFL
 */

#include <zephyr/device.h>
#include <zephyr/devicetree.h>
#include <zephyr/drivers/display.h>
#include <zephyr/kernel.h>
#include <lvgl.h>

#include "motor_control.h"

#define LOG_LEVEL CONFIG_LOG_DEFAULT_LEVEL
#include <zephyr/logging/log.h>
LOG_MODULE_REGISTER(app);

int main(void)
{
	const struct device *display_dev = DEVICE_DT_GET(DT_CHOSEN(zephyr_display));
	int ret;

	if (!device_is_ready(display_dev)) {
		LOG_ERR("Display device not ready");
		return 0;
	}

	/*
	 * Build the motor control UI (subjects, screens, logic + simulator)
	 * and load the run screen. Assets are compiled in, so the asset-path
	 * argument is unused on this target.
	 */
	motor_control_init("A:");

	/* Render one frame, then unblank the panel. */
	lv_timer_handler();
	ret = display_blanking_off(display_dev);
	if (ret < 0 && ret != -ENOSYS) {
		LOG_ERR("Failed to turn display blanking off (%d)", ret);
		return 0;
	}

	while (1) {
		uint32_t sleep_ms = lv_timer_handler();

		if (sleep_ms == LV_NO_TIMER_READY) {
			sleep_ms = LV_DEF_REFR_PERIOD;
		}
		k_sleep(K_MSEC(sleep_ms));
	}

	return 0;
}
```
