## CMakeLists.txt
```
# SPDX-FileCopyrightText: 2026 Texas Instruments Incorporated
# SPDX-License-Identifier: LicenseRef-TI-TFL

cmake_minimum_required(VERSION 3.20.0)

# Default the shield so "west build -b lp_mspm33c321a ." works out of the box;
# an explicit --shield still overrides.
if(NOT DEFINED SHIELD)
  set(SHIELD waveshare_3_5_rpi_lcd_f)
endif()

find_package(Zephyr REQUIRED HINTS $ENV{ZEPHYR_BASE})
project(washing_machine_app)

set(UI_DIR ${CMAKE_CURRENT_SOURCE_DIR}/ui)

include(${UI_DIR}/file_list_gen.cmake)
include(${UI_DIR}/user_config.cmake)

target_sources(app PRIVATE
    src/main.c
    ${LV_EDITOR_PROJECT_SOURCES}
)

target_include_directories(app PRIVATE ${UI_DIR})

# The vendored UI headers include "lvgl.h" (flat form); this guard selects it
# over "lvgl/lvgl.h" so it matches what Zephyr's LVGL module puts on the path.
target_compile_definitions(app PRIVATE LV_LVGL_H_INCLUDE_SIMPLE)
```

## sample.yaml
```
sample:
  name: TI MSPM33 LVGL Washing Machine UI
  description: >
    Washing-machine LVGL UI with Waveshare 3.5" RPi LCD (F) display on the
    LP-MSPM33C321A LaunchPad.
tests:
  application.washing_machine_app:
    tags:
      - lvgl
      - display
      - gui
    harness: none
    extra_args: SHIELD=waveshare_3_5_rpi_lcd_f
    platform_allow:
      - lp_mspm33c321a
```

## prj.conf
```kconfig
# SPDX-FileCopyrightText: 2026 Texas Instruments Incorporated
# SPDX-License-Identifier: LicenseRef-TI-TFL

CONFIG_DISPLAY=y
CONFIG_LVGL=y

CONFIG_MAIN_STACK_SIZE=12288
CONFIG_HEAP_MEM_POOL_SIZE=4096

CONFIG_LV_ATTRIBUTE_MEM_ALIGN_SIZE=4
CONFIG_LV_USE_OBSERVER=y
CONFIG_LV_USE_THEME_SIMPLE=y
CONFIG_LV_USE_LABEL=y
CONFIG_LV_USE_IMAGE=y
CONFIG_LV_USE_BUTTON=y
CONFIG_LV_USE_ARC=y
CONFIG_LV_USE_SLIDER=y
CONFIG_LV_COLOR_DEPTH_16=y
CONFIG_LV_FONT_MONTSERRAT_14=y
CONFIG_LV_USE_OBJ_NAME=y
CONFIG_LV_Z_POINTER_INPUT_MSGQ_COUNT=64
```

## boards/lp_mspm33c321a.conf
```kconfig
# SPDX-FileCopyrightText: 2026 Texas Instruments Incorporated
# SPDX-License-Identifier: LicenseRef-TI-TFL

CONFIG_LV_Z_VDB_SIZE=20
CONFIG_LV_Z_DOUBLE_VDB=y
CONFIG_LV_Z_MEM_POOL_SIZE=98304
CONFIG_LV_Z_FLUSH_THREAD=y
CONFIG_LV_Z_FLUSH_THREAD_STACK_SIZE=1024
CONFIG_LV_Z_FLUSH_THREAD_PRIORITY=-1
```

## boards/lp_mspm33c321a.overlay
```dts
/*
 * SPDX-FileCopyrightText: 2026 Texas Instruments Incorporated
 *
 * SPDX-License-Identifier: LicenseRef-TI-TFL
 */

&st7796s_display {
	madctl = <0xE8>;
};
```

## src/main.c
```c
/*
 * SPDX-FileCopyrightText: 2026 Texas Instruments Incorporated
 *
 * SPDX-License-Identifier: LicenseRef-TI-TFL
 *
 * Runs the vendored LVGL "washing machine" UI (see ui/, provenance in README.rst)
 * on a Zephyr display + touch. Zephyr auto-initializes LVGL and registers the
 * display/pointer devices via SYS_INIT (CONFIG_LV_Z_AUTO_INIT), so by the time
 * main() runs lv_init() has already happened and we only have to build the UI
 * and pump lv_timer_handler().
 */

#include <zephyr/device.h>
#include <zephyr/devicetree.h>
#include <zephyr/drivers/display.h>
#include <zephyr/kernel.h>
#include <lvgl.h>

#include "ti_washing_machine.h"

#define LOG_LEVEL CONFIG_LOG_DEFAULT_LEVEL
#include <zephyr/logging/log.h>
LOG_MODULE_REGISTER(app);

int main(void)
{
	const struct device *display_dev = DEVICE_DT_GET(DT_CHOSEN(zephyr_display));
	int ret;

	if (!device_is_ready(display_dev)) {
		LOG_ERR("Display device not ready");
		return 0;
	}
	
	lv_display_set_rotation(lv_display_get_default(), LV_DISPLAY_ROTATION_90);
	/* Build the washing machine UI (subjects, screens, logic + simulator)
	 * and load the home screen. Assets are compiled in, so the asset-path
	 * argument is unused on this target. */
	ti_washing_machine_init("A:");

	/* Render one frame, then enable the panel. */
	lv_timer_handler();
	ret = display_blanking_off(display_dev);
	if (ret < 0 && ret != -ENOSYS) {
		LOG_ERR("Failed to turn display blanking off (%d)", ret);
		return 0;
	}

	while (1) {
		uint32_t sleep_ms = lv_timer_handler();

		if (sleep_ms == LV_NO_TIMER_READY) {
			sleep_ms = LV_DEF_REFR_PERIOD;
		}
		k_sleep(K_MSEC(sleep_ms));
	}

	return 0;
}
```
