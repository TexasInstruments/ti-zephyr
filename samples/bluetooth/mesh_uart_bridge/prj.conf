## prj.conf
```kconfig
CONFIG_SYSTEM_WORKQUEUE_STACK_SIZE=2048
CONFIG_BT_MESH_SETTINGS_WORKQ_STACK_SIZE=2048

CONFIG_BT_SETTINGS=y
CONFIG_FLASH=y
CONFIG_FLASH_MAP=y
CONFIG_NVS=y
CONFIG_SETTINGS=y
CONFIG_HWINFO=y

CONFIG_BT=y
CONFIG_BT_L2CAP_TX_BUF_COUNT=5
CONFIG_BT_PERIPHERAL=y
CONFIG_BT_OBSERVER=y
CONFIG_BT_BROADCASTER=y

CONFIG_BT_CTLR_DUP_FILTER_LEN=0
CONFIG_BT_CTLR_LE_ENC=n
CONFIG_BT_CTLR_LE_PING=n
CONFIG_BT_DATA_LEN_UPDATE=n
CONFIG_BT_PHY_UPDATE=n
CONFIG_BT_CTLR_MIN_USED_CHAN=n
CONFIG_BT_CTLR_PRIVACY=n
CONFIG_BT_CTLR_CHAN_SEL_2=n

CONFIG_BT_MESH=y
CONFIG_BT_MESH_MODEL_EXTENSIONS=y
CONFIG_BT_MESH_RELAY=y
CONFIG_BT_MESH_FRIEND=y
CONFIG_BT_MESH_PB_GATT=y
CONFIG_BT_MESH_PB_ADV=y
CONFIG_BT_MESH_GATT_PROXY=y
CONFIG_BT_MESH_RX_SEG_MAX=32
CONFIG_BT_MESH_TX_SEG_MAX=32

CONFIG_BT_MESH_SUBNET_COUNT=2
CONFIG_BT_MESH_APP_KEY_COUNT=2
CONFIG_BT_MESH_MODEL_GROUP_COUNT=2
CONFIG_BT_MESH_LABEL_COUNT=3

CONFIG_BT_DEVICE_NAME="Zephyr Mesh UART Bridge"
CONFIG_SHELL=y
CONFIG_LOG_CMDS=n

CONFIG_BT_MESH_RPR_SRV=y

CONFIG_SECURE_STORAGE=y
```

## boards/lp_em_cc2340r53.overlay
```dts
/*
 * Copyright (c) 2025 Texas Instruments Incorporated
 * SPDX-License-Identifier: Apache-2.0
 */

&flash0 {
	partitions {
		compatible = "fixed-partitions";
		#address-cells = <1>;
		#size-cells = <1>;

		/* 16 KiB storage partition after slot1 (ends at 0x7c000) */
		storage_partition: partition@7c000 {
			label = "storage";
			reg = <0x0007c000 0x00004000>;
		};
	};
};
```

## src/main.c
```c
/* main.c - Application main entry point */

/*
 * Copyright (c) 2017 Intel Corporation
 * Copyright (c) 2025 Texas Instruments Incorporated
 *
 * SPDX-License-Identifier: Apache-2.0
 */

#include <zephyr/sys/printk.h>

#include <zephyr/settings/settings.h>
#include <zephyr/devicetree.h>
#include <zephyr/device.h>
#include <zephyr/drivers/gpio.h>
#include <zephyr/drivers/hwinfo.h>
#include <zephyr/sys/byteorder.h>

#include <zephyr/bluetooth/bluetooth.h>
#include <zephyr/bluetooth/mesh.h>

#include <zephyr/logging/log.h>
#include <zephyr/drivers/uart.h>
#include <zephyr/shell/shell.h>
#include <zephyr/shell/shell_uart.h>

#include "board.h"
#include "uart_bridge_model.h"

static const struct shell *uart_shell;

static void attention_on(const struct bt_mesh_model *mod)
{
	board_led_set(true);
}

static void attention_off(const struct bt_mesh_model *mod)
{
	board_led_set(false);
}

static int handle_payload(const struct bt_mesh_uart_bridge *uart_bridge,
						  struct bt_mesh_msg_ctx *ctx,
						  const uint8_t *payload)
{
	uint16_t addr = bt_mesh_model_elem(uart_bridge->model)->rt->addr;

	/* Do not print the payload if it came from this device */
	if (addr == ctx->addr)
    {
        return 0;
    }

	shell_print(uart_shell, "[0x%04x]: %s", ctx->addr, payload);

	return 0;
}

static const struct bt_mesh_health_srv_cb health_cb = {
	.attn_on = attention_on,
	.attn_off = attention_off,
};

static struct bt_mesh_health_srv health_srv = {
	.cb = &health_cb,
};

static const struct bt_mesh_uart_bridge_cb uart_bridge_cb = {
	.payload = handle_payload,
};

static struct bt_mesh_uart_bridge uart_bridge = {
	.cb = &uart_bridge_cb,
};

BT_MESH_HEALTH_PUB_DEFINE(health_pub, 0);


/* This application only needs one element to contain its models */
static const struct bt_mesh_model models[] = {
	BT_MESH_MODEL_CFG_SRV,
	BT_MESH_MODEL_HEALTH_SRV(&health_srv, &health_pub),
	BT_MESH_MODEL_RPR_SRV,
};

/* Vendor models */
static const struct bt_mesh_model vnd_models[] = {
	BT_MESH_MODEL_UART_BRIDGE(&uart_bridge)
};

static const struct bt_mesh_elem elements[] = {
	BT_MESH_ELEM(0, models, vnd_models)
};

static const struct bt_mesh_comp comp = {
	.cid = CONFIG_BT_COMPANY_ID,
	.elem = elements,
	.elem_count = ARRAY_SIZE(elements),
};

/* Provisioning */

static int output_number(bt_mesh_output_action_t action, uint8_t *numeric, size_t size)
{
	uint32_t number = 0;

	for (size_t i = 0; i < size && i < sizeof(number); i++) {
		number = (number << 8) | numeric[i];
	}

	printk("OOB Number: %u\n", number);

	board_output_number(action, number);

	return 0;
}

static void prov_complete(uint16_t net_idx, uint16_t addr)
{
	board_prov_complete();
}

static void prov_reset(void)
{
	bt_mesh_prov_enable(BT_MESH_PROV_ADV | BT_MESH_PROV_GATT);
}

static uint8_t dev_uuid[16];

static const struct bt_mesh_prov prov = {
	.uuid = dev_uuid,
	.output_size = 4,
	.output_actions = BT_MESH_DISPLAY_NUMBER,
	.output_numeric = output_number,
	.complete = prov_complete,
	.reset = prov_reset,
};

static void bt_ready(int err)
{
	if (err) {
		printk("Bluetooth init failed (err %d)\n", err);
		return;
	}

	printk("Bluetooth initialized\n");

	err = bt_mesh_init(&prov, &comp);
	if (err) {
		printk("Initializing mesh failed (err %d)\n", err);
		return;
	}

	if (IS_ENABLED(CONFIG_SETTINGS)) {
		settings_load();
	}

	/* This will be a no-op if settings_load() loaded provisioning info */
	bt_mesh_prov_enable(BT_MESH_PROV_ADV | BT_MESH_PROV_GATT);

	printk("Mesh initialized\n");
}

/* UART shell command callbacks */
static int cmd_bridge(const struct shell *sh, size_t argc, char **argv)
{
	if (argc == 1) {
		shell_help(sh);
		return 1;
	}
	return -EINVAL;
}

static int cmd_payload_send(const struct shell *sh, size_t argc, char **argv)
{
	uint16_t addr = bt_mesh_model_elem(uart_bridge.model)->rt->addr;
	shell_print(sh, "[0x%04x]: %s", addr, argv[1]);

	return bt_mesh_uart_bridge_payload_send(uart_bridge.model, argv[1]);
}

/* UART shell commands */
SHELL_STATIC_SUBCMD_SET_CREATE(bridge_cmds,
	SHELL_CMD_ARG(payload, NULL, "Send payload", cmd_payload_send, 1, 1),
	SHELL_SUBCMD_SET_END
);

SHELL_CMD_ARG_REGISTER(bridge, &bridge_cmds,
					   "Bluetooth Mesh UART Bridge commands",
					   cmd_bridge, 1, 1);

int main(void)
{
	int err = -1;

	printk("Initializing...\n");

	if (IS_ENABLED(CONFIG_HWINFO)) {
		err = hwinfo_get_device_id(dev_uuid, sizeof(dev_uuid));
	}

	if (err < 0) {
		dev_uuid[0] = 0xdd;
		dev_uuid[1] = 0xdd;
	}

	err = board_init();
	if (err) {
		printk("Board init failed (err: %d)\n", err);
		return 0;
	}

	uart_shell = shell_backend_uart_get_ptr();
	if (!uart_shell) {
		printk("UART shell backend not available\n");
		return 0;
	}

	/* Initialize the Bluetooth Subsystem */
	err = bt_enable(bt_ready);
	if (err) {
		printk("Bluetooth init failed (err %d)\n", err);
	}

	return 0;
}
```
