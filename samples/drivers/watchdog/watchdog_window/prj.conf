## CMakeLists.txt
```
#
# SPDX-FileCopyrightText: 2026 Texas Instruments Incorporated
#
# SPDX-License-Identifier: LicenseRef-TI-TFL
#

cmake_minimum_required(VERSION 3.28.0)
find_package(Zephyr REQUIRED HINTS $ENV{ZEPHYR_BASE})
project(watchdog_window)

target_sources(app PRIVATE src/main.c)
```

## sample.yaml
```
# SPDX-FileCopyrightText: 2026 Texas Instruments Incorporated
# SPDX-License-Identifier: LicenseRef-TI-TFL

sample:
  name: TI WWDT Window Mode
  description: >
    Demonstrates the Window Watchdog Timer (WWDT) closed-window constraint.
    Feeds correctly inside the open window, then deliberately feeds too early
    to trigger a SYSRST. On reboot, SYSCTL.RSTCAUSE (read-to-clear) reports
    SYSWWDT0, confirming the violation. The upstream watchdog sample sets
    WDT_MIN_WINDOW=0; this sample exercises min > 0.
common:
  tags:
    - drivers
    - watchdog
    - ti
  depends_on: watchdog
  harness: console
  harness_config:
    type: multi_line
    ordered: true
    regex:
      - "TI WWDT Window Mode"
      - "WWDT window:.*min=[0-9]+ ms.*max=[0-9]+ ms"
      - "Phase 1:"
      - "Feed 1/[0-9]+:.*OK"
      - "expects SYSRST"
tests:
  sample.drivers.watchdog.window:
    platform_allow:
      - lp_mspm0g3507
      - lp_mspm0g3519
      - lp_mspm0l2228
      - lp_mspm33c321a
      - lp_am13e230
    timeout: 15
```

## prj.conf
```kconfig
# SPDX-FileCopyrightText: 2026 Texas Instruments Incorporated
# SPDX-License-Identifier: LicenseRef-TI-TFL

CONFIG_WATCHDOG=y
CONFIG_HWINFO=y
```

## boards/lp_mspm0g3507.overlay
```dts
/*
 * Copyright (c) 2026 Texas Instruments Incorporated
 *
 * SPDX-License-Identifier: BSD-3-Clause
 */

/ {
	aliases {
		watchdog0 = &wdt0;
	};
};

&wdt0 {
	status = "okay";
};
```

## boards/lp_mspm0l2228.overlay
```dts
/*
 * SPDX-FileCopyrightText: 2026 Texas Instruments Incorporated
 *
 * SPDX-License-Identifier: LicenseRef-TI-TFL
 */

/ {
	aliases {
		watchdog0 = &wdt0;
	};
};

&wdt0 {
	status = "okay";
};
```

## src/main.c
```c
/*
 * SPDX-FileCopyrightText: 2026 Texas Instruments Incorporated
 *
 * SPDX-License-Identifier: LicenseRef-TI-TFL
 */

/**
 * @file
 * @brief TI WWDT Window Mode
 *
 * Demonstrates the Window Watchdog Timer (WWDT) closed-window constraint
 * using the standard Zephyr watchdog API.
 *
 * The WWDT enforces a feed window:
 *
 *   t=0 ---- closed window ---- t=min == open window == t=max ---- RESET
 *
 * - Feed before t=min: immediate SYSRST (closed-window violation)
 * - Feed after  t=max: immediate SYSRST (timeout)
 * - Feed in [t=min, t=max): safe zone
 *
 * The upstream watchdog sample sets WDT_MIN_WINDOW=0 so the closed window is
 * never exercised. This sample demonstrates all three zones across
 * two boots:
 *
 *   Boot 1: five correct feeds at 1000 ms, then a deliberate early feed at
 *           100 ms triggers a SYSRST.
 *   Boot 2: SYSCTL.RSTCAUSE register (read-to-clear) reports SYSWWDT0
 *           violation, confirming the window violation; sample then feeds
 *           correctly.
 *
 * Reset cause is read directly from the SYSCTL RSTCAUSE register (offset
 * 0x1220 from SYSCTL base) without using the hwinfo driver, making this
 * sample portable to SoCs where a native hwinfo driver is not yet available.
 *
 * SDK analog: wwdt_window_mode_periodic_reset
 *
 * Note: WWDT violations route through the ESM safety block, not the NVIC,
 * so a pre-reset callback is architecturally impossible.
 */

#include <zephyr/kernel.h>
#include <zephyr/device.h>
#include <zephyr/drivers/watchdog.h>
#include <zephyr/sys/sys_io.h>
#include <stdio.h>

#if !DT_HAS_COMPAT_STATUS_OKAY(ti_mspm0_watchdog)
#error "No ti,mspm0-watchdog node. Add 'watchdog0 = &wdt0' alias to the board overlay."
#endif

#define WDT_NODE DT_ALIAS(watchdog0)

/*
 * The WWDT reset action is a DT property: 0 = CPU_CORE reset, 1 = SOC reset.
 * Derive the flag from the same DT property the driver uses so that
 * wdt_install_timeout() does not reject a mismatched flag.
 */
#define WDT_RESET_FLAG                                                                             \
	((DT_PROP(WDT_NODE, ti_watchdog_reset_action) != 0) ? WDT_FLAG_RESET_SOC                   \
							    : WDT_FLAG_RESET_CPU_CORE)

#define WIN_MIN_MS    500U  /* closed window: feed inside here = SYSRST  */
#define WIN_MAX_MS    2000U /* open window:   feed after this  = SYSRST  */
#define FEED_SAFE_MS  1000U /* safe feed interval (inside open window)   */
#define FEED_EARLY_MS 100U  /* intentional violation: inside closed window */
#define CORRECT_FEEDS 5     /* correct feeds before triggering violation  */

/*
 * SYSCTL RSTCAUSE register — same base address and layout across MSPM0,
 * MSPM33, and AM13 families (all share the same SYSCTL peripheral).
 * The field is read-to-clear, so a single read both retrieves and resets it.
 */
#define WDT_SAMPLE_SYSCTL_BASE         DT_REG_ADDR(DT_NODELABEL(sysctl))
#define WDT_SAMPLE_RSTCAUSE_OFS        0x1220U
#define WDT_SAMPLE_RSTCAUSE_ID_MASK    0x1FU
#define WDT_SAMPLE_RSTCAUSE_SYSWWDT0   0x0EU /* WWDT0 closed-window or timeout violation */
#define WDT_SAMPLE_RSTCAUSE_SYSWWDT1   0x13U /* WWDT1 closed-window or timeout violation */

static bool ti_wdt_reboot(void)
{
	uint32_t cause = sys_read32(WDT_SAMPLE_SYSCTL_BASE + WDT_SAMPLE_RSTCAUSE_OFS) &
			 WDT_SAMPLE_RSTCAUSE_ID_MASK;

	return (cause == WDT_SAMPLE_RSTCAUSE_SYSWWDT0) || (cause == WDT_SAMPLE_RSTCAUSE_SYSWWDT1);
}

int main(void)
{
	const struct device *wdt = DEVICE_DT_GET(WDT_NODE);
	bool wdt_reboot = ti_wdt_reboot(); /* read-to-clear: call once at boot */
	uint32_t t_start;
	uint32_t t_feed;
	int wdt_ch;
	int ret;

	if (!device_is_ready(wdt)) {
		printf("Error: %s not ready\n", wdt->name);
		return -ENODEV;
	}

	printf("TI WWDT Window Mode\n");

	if (wdt_reboot) {
		printf("*** Rebooted by WWDT window violation ***\n\n");
	} else {
		printf("Clean boot.\n\n");
	}

	struct wdt_timeout_cfg wdt_cfg = {
		.flags = WDT_RESET_FLAG,
		.window = {
			.min = WIN_MIN_MS,
			.max = WIN_MAX_MS,
		},
		.callback = NULL,
	};

	wdt_ch = wdt_install_timeout(wdt, &wdt_cfg);
	if (wdt_ch < 0) {
		printf("Error: wdt_install_timeout: %d\n", wdt_ch);
		return wdt_ch;
	}

	ret = wdt_setup(wdt, WDT_OPT_PAUSE_HALTED_BY_DBG);
	if (ret < 0) {
		printf("Error: wdt_setup: %d\n", ret);
		return ret;
	}

	/*
	 * Record the start time immediately after wdt_setup() so that elapsed
	 * measurements track the WWDT window precisely from the point the
	 * counter began running.
	 */
	t_start = k_uptime_get_32();
	t_feed = t_start;

	printf("WWDT window:  min=%u ms (closed)  max=%u ms (open)\n", WIN_MIN_MS, WIN_MAX_MS);
	printf("Feed interval: %u ms (inside open window)\n\n", FEED_SAFE_MS);

	/* ------------------------------------------------------------------ */
	/* Phase 2: recovered from violation -- feed correctly                 */
	/* ------------------------------------------------------------------ */
	if (wdt_reboot) {
		printf("Phase 2: recovered -- feeding correctly.\n");

		for (int n = 1; n <= CORRECT_FEEDS; n++) {
			k_msleep(FEED_SAFE_MS);
			uint32_t elapsed = k_uptime_get_32() - t_feed;

			wdt_feed(wdt, wdt_ch);
			t_feed = k_uptime_get_32();

			printf("  Feed %2d: %u ms (window=[%u..%u) ms)\n", n, elapsed, WIN_MIN_MS,
			       WIN_MAX_MS);
		}

		printf("Window-mode recovery confirmed. Done.\n");

		while (1) {
			k_msleep(FEED_SAFE_MS);
			wdt_feed(wdt, wdt_ch);
		}
	}

	/* ------------------------------------------------------------------ */
	/* Phase 1: correct feeds, then deliberate closed-window violation     */
	/* ------------------------------------------------------------------ */
	printf("Phase 1: %d correct feeds, then deliberate early feed.\n\n", CORRECT_FEEDS);

	for (int i = 0; i < CORRECT_FEEDS; i++) {
		k_msleep(FEED_SAFE_MS);
		uint32_t elapsed = k_uptime_get_32() - t_feed;

		wdt_feed(wdt, wdt_ch);
		t_feed = k_uptime_get_32();

		printf("  Feed %d/%d: %u ms -- OK (inside window)\n", i + 1, CORRECT_FEEDS,
		       elapsed);
	}

	printf("\nFeeding at %u ms (before min=%u ms) -- expects SYSRST...\n", FEED_EARLY_MS,
	       WIN_MIN_MS);

	k_msleep(FEED_EARLY_MS);
	wdt_feed(wdt, wdt_ch); /* inside closed window: t < min -> SYSRST */

	/* Should not reach here */
	printf("Error: early feed did not trigger reset\n");

	return 0;
}
```
