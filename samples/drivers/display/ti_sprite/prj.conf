## CMakeLists.txt
```
# SPDX-FileCopyrightText: 2026 Texas Instruments Incorporated
# SPDX-License-Identifier: LicenseRef-TI-TFL

cmake_minimum_required(VERSION 3.20.0)
find_package(Zephyr REQUIRED HINTS $ENV{ZEPHYR_BASE})
project(display_tidss_sprite)

target_sources(app PRIVATE src/main.c)
```

## Kconfig
```
# SPDX-FileCopyrightText: 2026 Texas Instruments Incorporated
# SPDX-License-Identifier: LicenseRef-TI-TFL

mainmenu "TI DSS sprite animation sample"

source "Kconfig.zephyr"

config HEAP_MEM_POOL_ADD_SIZE_SAMPLE
	int "Framebuffer heap pool addition (bytes)"
	default 16777216
	help
	  Additional bytes added to the system heap pool.  Must be at least
	  2 x width x height x 4 bytes for the two ARGB8888 framebuffers.
	  Default covers 2 x 1920x1080 (16 MB).
```

## sample.yaml
```
sample:
  name: TI DSS Sprite Animation
  description: >
    Renders a TI logo sprite that slides in a serpentine (boustrophedon)
    pattern across the full display, using the non-blocking, VSYNC-callback
    driven path of the TI DSS (tidss) display driver. The display refresh
    rate is the sole pacing mechanism; no k_msleep() is used.
common:
  tags:
    - drivers
    - display
    - ti
  depends_on: display
tests:
  sample.drivers.display.ti_sprite.dsi_rpi_panel:
    platform_allow:
      - am62l_evm/am62l3/a53
  sample.drivers.display.ti_sprite.dpi_hdmi:
    platform_allow:
      - am62l_evm/am62l3/a53
    extra_args: DTC_OVERLAY_FILE="boards/am62l_evm_am62l3_a53_hdmi.overlay"
```

## prj.conf
```kconfig
# SPDX-FileCopyrightText: 2026 Texas Instruments Incorporated
# SPDX-License-Identifier: LicenseRef-TI-TFL

CONFIG_DISPLAY=y
CONFIG_LV_COLOR_DEPTH_32=y
CONFIG_LOG=y
```

## boards/am62l_evm_am62l3_a53.conf
```kconfig
# SPDX-FileCopyrightText: 2026 Texas Instruments Incorporated
# SPDX-License-Identifier: LicenseRef-TI-TFL

CONFIG_SPEED_OPTIMIZATIONS=y
CONFIG_ILI9881C_DSI_RPI_TOUCH_DISPLAY=y
```

## boards/am62l_evm_am62l3_a53.overlay
```dts
/*
 * SPDX-FileCopyrightText: 2026 Texas Instruments Incorporated
 *
 * SPDX-License-Identifier: LicenseRef-TI-TFL
 */

/*
 * Default am62l_evm route, auto-applied by the build system for this board:
 * DSS VP -> Cadence DSI TX -> Raspberry Pi Touch Display 2 (ILI9881C,
 * 720x1280, 2 data lanes, RGB888).
 *
 * The board's default &dss timings (720x1280 @ 83.33 MHz) already match
 * this panel, so only the DSI host, the panel node, and the on-board MCU
 * (backlight + reset, reached over main_i2c0) need enabling. zephyr,display
 * stays pointed at &dss so this sample keeps its ARGB8888 framebuffer path;
 * the panel's own init sequence starts the DSI link independently.
 *
 * For the DPI + HDMI route instead, see am62l_evm_am62l3_a53_hdmi.overlay.
 */

&main_i2c0 {
	status = "okay";
};

&display_mcu {
	status = "okay";
};

&dsi0 {
	data-lanes = <2>;

	rpi_td2: panel@0 {
		status = "okay";
	};
};
```

## boards/am62l_evm_am62l3_a53_hdmi.overlay
```dts
/*
 * SPDX-FileCopyrightText: 2026 Texas Instruments Incorporated
 *
 * SPDX-License-Identifier: LicenseRef-TI-TFL
 */

/*
 * Alternate am62l_evm route: DSS VP -> 24-bit parallel DPI -> SII9022A ->
 * HDMI. The default route for this board is boards/am62l_evm_am62l3_a53.overlay
 * (DSI + Raspberry Pi panel); setting DTC_OVERLAY_FILE below replaces that
 * default lookup with just this file.
 *
 * Overrides the board's default 720x1280 DSI panel timings with a
 * 1920x1080@60 Hz DPI mode, muxes the dss_vout0_* pins, and enables the
 * SII9022A HDMI bridge on main_i2c1.
 *
 * Apply with:
 *   west build ... -- -DDTC_OVERLAY_FILE=boards/am62l_evm_am62l3_a53_hdmi.overlay
 */

&dss {
	pinctrl-0 = <&dss_vout0_data0>,
		    <&dss_vout0_data1>,
		    <&dss_vout0_data2>,
		    <&dss_vout0_data3>,
		    <&dss_vout0_data4>,
		    <&dss_vout0_data5>,
		    <&dss_vout0_data6>,
		    <&dss_vout0_data7>,
		    <&dss_vout0_data8>,
		    <&dss_vout0_data9>,
		    <&dss_vout0_data10>,
		    <&dss_vout0_data11>,
		    <&dss_vout0_data12>,
		    <&dss_vout0_data13>,
		    <&dss_vout0_data14>,
		    <&dss_vout0_data15>,
		    <&dss_vout0_data16>,
		    <&dss_vout0_data17>,
		    <&dss_vout0_data18>,
		    <&dss_vout0_data19>,
		    <&dss_vout0_data20>,
		    <&dss_vout0_data21>,
		    <&dss_vout0_data22>,
		    <&dss_vout0_data23>,
		    <&dss_vout0_de>,
		    <&dss_vout0_extpclkin>,
		    <&dss_vout0_hsync>,
		    <&dss_vout0_pclk>,
		    <&dss_vout0_vsync>;
	pinctrl-names = "default";

	data-width = <24>;
	height = <1080>;
	width = <1920>;

	display-timings {
		compatible = "zephyr,panel-timing";
		clock-frequency = <148500000>;
		hfront-porch = <88>;
		hback-porch = <148>;
		hsync-len = <44>;
		vfront-porch = <4>;
		vback-porch = <36>;
		vsync-len = <5>;
		hsync-active = <1>;
		vsync-active = <1>;
		de-active = <1>;
		pixelclk-active = <0>;
	};

	status = "okay";
};

&main_i2c1 {
	status = "okay";
};

&sii9022a {
	status = "okay";
};
```

## src/main.c
```c
/*
 * SPDX-FileCopyrightText: 2026 Texas Instruments Incorporated
 *
 * SPDX-License-Identifier: LicenseRef-TI-TFL
 */

/*
 * TI DSS sprite animation sample — callback-driven
 *
 * Renders a TI logo sprite that slides in small pixel steps in a serpentine
 * (boustrophedon) pattern across the full display window: each row is swept
 * in the opposite direction of the row before it.  The animation loop uses
 * the callback approach implemented in display_tidss.c:
 *
 *   1. display_write() is non-blocking: it enqueues the buffer into the
 *      driver's request queue and returns immediately.
 *   2. At each VSYNC the driver ISR (tidss_isr) dequeues the next buffer,
 *      latches it into the DSS shadow registers, and fires the registered
 *      vsync_cb from ISR context.
 *   3. vsync_cb gives a semaphore that the main thread is blocked on.
 *   4. Once unblocked, the main thread advances the sprite position, renders
 *      the next frame, and calls display_write() again.
 *
 * The display refresh rate is the sole pacing mechanism; no k_msleep() is
 * used anywhere in the animation loop.
 */

#define LOG_LEVEL CONFIG_LOG_DEFAULT_LEVEL
#include <zephyr/logging/log.h>
LOG_MODULE_REGISTER(tidss_sprite);

#include <zephyr/kernel.h>
#include <zephyr/device.h>
#include <zephyr/drivers/display.h>
#include <zephyr/sys/util.h>

/* Sprite dimensions (pixels) */
#define SPRITE_W  128
#define SPRITE_H  128

/* Pixel step per VSYNC; smaller than SPRITE_W/H for a slow, smooth slide. */
#define STEP_PX   8

/* ARGB8888 pixel constants (0xAARRGGBB) */
#define COLOR_BG    0xFF0F1923U   /* dark navy background   */
#define COLOR_RED   0xFFCC0000U   /* TI brand red           */

/*
 * Semaphore used to synchronise the main thread with the VSYNC callback.
 * Initial count 0: main thread blocks on k_sem_take() until vsync_cb fires.
 */
static K_SEM_DEFINE(vsync_sem, 0, 1);

/*
 * VSYNC callback — called from tidss_isr() in ISR context whenever the DSS
 * latches a new buffer at VSYNC.  Unblocks the main thread so it can render
 * the next frame and issue the next display_write().
 */
static enum display_event_result vsync_cb(const struct device *dev,
					  uint32_t evt,
					  const struct display_event_data *data,
					  void *user_data)
{
	ARG_UNUSED(dev);
	ARG_UNUSED(evt);
	ARG_UNUSED(data);
	ARG_UNUSED(user_data);

	k_sem_give(&vsync_sem);

	return DISPLAY_EVENT_RESULT_HANDLED;
}

/*
 * Static sprite buffer — built once by sprite_init(), then blitted into
 * every frame.  Placed in .bss to keep stack usage low.
 */
static uint32_t g_sprite[SPRITE_W * SPRITE_H];

/*
 * 1-bit-per-pixel bitmap of the TI logo (the Texas outline with the "ti"
 * wordmark cut out of it), downsampled from the official artwork to the
 * sprite's SPRITE_W x SPRITE_H resolution.  Each row is packed MSB-first
 * into SPRITE_W / 8 bytes; a set bit is TI red, a clear bit is the cut-out
 * "ti" lettering or the area outside the Texas outline, both of which let
 * the frame's background colour show through — matching how the source
 * PNG's transparency would composite onto any backdrop.
 */
static const uint8_t ti_logo_bitmap[SPRITE_H][SPRITE_W / 8] = {
	{ 0x00, 0x00, 0x00, 0x00, 0x0f, 0xff, 0xff, 0xff, 0x80, 0x00, 0x00, 0x00, 0x00, 0x00, 0x00, 0x00 },
	{ 0x00, 0x00, 0x00, 0x00, 0x1f, 0xff, 0xff, 0xff, 0x80, 0x00, 0x00, 0x00, 0x00, 0x00, 0x00, 0x00 },
	{ 0x00, 0x00, 0x00, 0x00, 0x0f, 0xff, 0xff, 0xff, 0x80, 0x00, 0x00, 0x00, 0x00, 0x00, 0x00, 0x00 },
	{ 0x00, 0x00, 0x00, 0x00, 0x0f, 0xff, 0xff, 0xff, 0x80, 0x00, 0x00, 0x00, 0x00, 0x00, 0x00, 0x00 },
	{ 0x00, 0x00, 0x00, 0x00, 0x0f, 0xff, 0xff, 0xff, 0x80, 0x00, 0x00, 0x00, 0x00, 0x00, 0x00, 0x00 },
	{ 0x00, 0x00, 0x00, 0x00, 0x0f, 0xff, 0xff, 0xff, 0x80, 0x00, 0x00, 0x00, 0x00, 0x00, 0x00, 0x00 },
	{ 0x00, 0x00, 0x00, 0x00, 0x0f, 0xff, 0xff, 0xff, 0x80, 0x00, 0x00, 0x00, 0x00, 0x00, 0x00, 0x00 },
	{ 0x00, 0x00, 0x00, 0x00, 0x0f, 0xff, 0xff, 0xff, 0x80, 0x00, 0x3f, 0xfc, 0x00, 0x00, 0x00, 0x00 },
	{ 0x00, 0x00, 0x00, 0x00, 0x0f, 0xff, 0xff, 0xff, 0x80, 0x00, 0x3f, 0xfc, 0x00, 0x00, 0x00, 0x00 },
	{ 0x00, 0x00, 0x00, 0x00, 0x0f, 0xff, 0xff, 0xff, 0x80, 0x00, 0x7f, 0xf8, 0x00, 0x00, 0x00, 0x00 },
	{ 0x00, 0x00, 0x00, 0x00, 0x0f, 0xff, 0xff, 0xff, 0x80, 0x00, 0x7f, 0xf8, 0x00, 0x00, 0x00, 0x00 },
	{ 0x00, 0x00, 0x00, 0x00, 0x0f, 0xff, 0xff, 0xff, 0x80, 0x00, 0x7f, 0xf8, 0x00, 0x00, 0x00, 0x00 },
	{ 0x00, 0x00, 0x00, 0x00, 0x0f, 0xff, 0xff, 0xff, 0x80, 0x00, 0x7f, 0xf8, 0x00, 0x00, 0x00, 0x00 },
	{ 0x00, 0x00, 0x00, 0x00, 0x0f, 0xff, 0xff, 0xff, 0x80, 0x00, 0x7f, 0xf8, 0x00, 0x00, 0x00, 0x00 },
	{ 0x00, 0x00, 0x00, 0x00, 0x0f, 0xff, 0xff, 0xff, 0x80, 0x00, 0xff, 0xf0, 0x00, 0x00, 0x00, 0x00 },
	{ 0x00, 0x00, 0x00, 0x00, 0x0f, 0xff, 0xff, 0xff, 0x80, 0x00, 0xff, 0xf0, 0x00, 0x00, 0x00, 0x00 },
	{ 0x00, 0x00, 0x00, 0x00, 0x0f, 0xff, 0xff, 0xff, 0x80, 0x00, 0xff, 0xf0, 0x00, 0x00, 0x00, 0x00 },
	{ 0x00, 0x00, 0x00, 0x00, 0x0f, 0xff, 0xff, 0xff, 0x80, 0x00, 0xff, 0xf0, 0x00, 0x00, 0x00, 0x00 },
	{ 0x00, 0x00, 0x00, 0x00, 0x0f, 0xff, 0xff, 0xff, 0x80, 0x00, 0xff, 0xf0, 0x00, 0x00, 0x00, 0x00 },
	{ 0x00, 0x00, 0x00, 0x00, 0x0f, 0xff, 0xff, 0xff, 0x80, 0x00, 0x00, 0x00, 0x00, 0x00, 0x00, 0x00 },
	{ 0x00, 0x00, 0x00, 0x00, 0x0f, 0xff, 0xff, 0xff, 0x80, 0x00, 0x00, 0x00, 0x00, 0x00, 0x00, 0x00 },
	{ 0x00, 0x00, 0x00, 0x00, 0x0f, 0xff, 0xff, 0xff, 0x80, 0x00, 0x00, 0x00, 0x00, 0x00, 0x00, 0x00 },
	{ 0x00, 0x00, 0x00, 0x00, 0x0f, 0xff, 0xff, 0xff, 0x80, 0x00, 0x00, 0x00, 0x00, 0x00, 0x00, 0x00 },
	{ 0x00, 0x00, 0x00, 0x00, 0x0f, 0xff, 0xff, 0xff, 0x80, 0x00, 0x00, 0x00, 0x00, 0x00, 0x00, 0x00 },
	{ 0x00, 0x00, 0x00, 0x00, 0x0f, 0xff, 0xff, 0xff, 0xff, 0x81, 0xff, 0xc0, 0xff, 0xff, 0xff, 0x00 },
	{ 0x00, 0x00, 0x00, 0x00, 0x0f, 0xff, 0xff, 0xff, 0xff, 0x83, 0xff, 0xc0, 0xff, 0xff, 0xff, 0x80 },
	{ 0x00, 0x00, 0x00, 0x00, 0x0f, 0xff, 0xff, 0xff, 0xff, 0x83, 0xff, 0xc1, 0xff, 0xff, 0xff, 0x80 },
	{ 0x00, 0x00, 0x00, 0x00, 0x0f, 0xff, 0xff, 0xff, 0xff, 0x83, 0xff, 0xc1, 0xff, 0xff, 0xff, 0x80 },
	{ 0x00, 0x00, 0x00, 0x00, 0x0f, 0xff, 0xff, 0xff, 0xff, 0x03, 0xff, 0xc1, 0xff, 0xff, 0xff, 0x80 },
	{ 0x00, 0x00, 0x00, 0x00, 0x0f, 0xff, 0xff, 0xff, 0xff, 0x03, 0xff, 0xc1, 0xff, 0xff, 0xff, 0x80 },
	{ 0x00, 0x00, 0x00, 0x00, 0x0f, 0xff, 0xff, 0xff, 0xff, 0x07, 0xff, 0x81, 0xff, 0xff, 0xff, 0x80 },
	{ 0x00, 0x00, 0x00, 0x00, 0x0f, 0xff, 0xff, 0xff, 0xff, 0x07, 0xff, 0x83, 0xff, 0xff, 0xff, 0x80 },
	{ 0x00, 0x00, 0x00, 0x00, 0x0f, 0xff, 0xff, 0xff, 0xff, 0x07, 0xff, 0x83, 0xff, 0xff, 0xff, 0x80 },
	{ 0x00, 0x00, 0x00, 0x00, 0x0f, 0xff, 0xff, 0xff, 0xfe, 0x07, 0xff, 0x83, 0xff, 0xff, 0xff, 0x80 },
	{ 0x00, 0x00, 0x00, 0x00, 0x0f, 0xff, 0xff, 0xff, 0xfe, 0x07, 0xff, 0x83, 0xff, 0xff, 0xff, 0x80 },
	{ 0x00, 0x00, 0x00, 0x00, 0x0f, 0xff, 0xff, 0xff, 0xfe, 0x0f, 0xff, 0x83, 0xff, 0xff, 0xff, 0x80 },
	{ 0x00, 0x00, 0x00, 0x00, 0x0f, 0xff, 0xff, 0xff, 0xfe, 0x0f, 0xff, 0x03, 0xff, 0xff, 0xff, 0x80 },
	{ 0x00, 0x00, 0x00, 0x00, 0x0f, 0xff, 0xff, 0xff, 0xfe, 0x0f, 0xff, 0x07, 0xff, 0xff, 0xff, 0x80 },
	{ 0x00, 0x00, 0x00, 0x00, 0x0f, 0xff, 0xff, 0xff, 0xfc, 0x0f, 0xff, 0x07, 0xff, 0xff, 0xff, 0x80 },
	{ 0x00, 0x00, 0x00, 0x00, 0x0f, 0xff, 0xff, 0xff, 0xfc, 0x0f, 0xff, 0x07, 0xff, 0xff, 0xff, 0x80 },
	{ 0x00, 0x00, 0x00, 0x00, 0x0f, 0xff, 0xff, 0xfc, 0x00, 0x0f, 0xff, 0x00, 0x07, 0xff, 0xff, 0x80 },
	{ 0x00, 0x00, 0x00, 0x00, 0x0f, 0xff, 0xff, 0xf8, 0x00, 0x1f, 0xfe, 0x00, 0x07, 0xff, 0xff, 0x80 },
	{ 0x00, 0x00, 0x00, 0x00, 0x0f, 0xff, 0xff, 0xf8, 0x00, 0x1f, 0xfe, 0x00, 0x07, 0xff, 0xff, 0x80 },
	{ 0x00, 0x00, 0x00, 0x00, 0x0f, 0xff, 0xff, 0xf8, 0x00, 0x1f, 0xfe, 0x00, 0x07, 0xff, 0xff, 0x80 },
	{ 0x00, 0x00, 0x00, 0x00, 0x0f, 0xff, 0xff, 0xf8, 0x00, 0x1f, 0xfe, 0x00, 0x07, 0xff, 0xff, 0x80 },
	{ 0x00, 0x00, 0x00, 0x00, 0x0f, 0xff, 0xff, 0xf0, 0x00, 0x1f, 0xfe, 0x00, 0x07, 0xff, 0xff, 0x80 },
	{ 0x00, 0x00, 0x00, 0x00, 0x0f, 0xff, 0xff, 0xf0, 0x00, 0x3f, 0xfc, 0x00, 0x0f, 0xff, 0xff, 0xc0 },
	{ 0x00, 0x00, 0x00, 0x00, 0x0f, 0xff, 0xff, 0xf0, 0x00, 0x3f, 0xfc, 0x00, 0x0f, 0xff, 0xff, 0xc0 },
	{ 0x00, 0x00, 0x00, 0x00, 0x0f, 0xff, 0xff, 0xf0, 0x00, 0x3f, 0xfc, 0x00, 0x0f, 0xff, 0xff, 0xc0 },
	{ 0xff, 0xff, 0xff, 0xff, 0xff, 0xff, 0xff, 0xf0, 0x00, 0x3f, 0xfc, 0x00, 0x0f, 0xff, 0xff, 0xe0 },
	{ 0xff, 0xff, 0xff, 0xff, 0xff, 0xff, 0xff, 0xf0, 0x00, 0x3f, 0xfc, 0x00, 0x0f, 0xff, 0xff, 0xe0 },
	{ 0xff, 0xff, 0xff, 0xff, 0xff, 0xff, 0xff, 0xe0, 0x00, 0x7f, 0xf8, 0x00, 0x1f, 0xff, 0xff, 0xf0 },
	{ 0xff, 0xff, 0xff, 0xff, 0xff, 0xff, 0xff, 0xe0, 0x00, 0x7f, 0xf8, 0x00, 0x1f, 0xff, 0xff, 0xf8 },
	{ 0x7f, 0xff, 0xff, 0xff, 0xff, 0xff, 0xff, 0xe0, 0x00, 0x7f, 0xf8, 0x00, 0x1f, 0xff, 0xff, 0xfc },
	{ 0x7f, 0xff, 0xff, 0xff, 0xff, 0xff, 0xff, 0xe0, 0x00, 0x7f, 0xf8, 0x00, 0x1f, 0xff, 0xff, 0xfe },
	{ 0x7f, 0xff, 0xff, 0xff, 0xff, 0xff, 0xff, 0xff, 0xe0, 0x7f, 0xf8, 0x3f, 0xff, 0xff, 0xff, 0xff },
	{ 0x3f, 0xff, 0xff, 0xff, 0xff, 0xff, 0xff, 0xff, 0xe0, 0xff, 0xf0, 0x3f, 0xff, 0xff, 0xff, 0xff },
	{ 0x3f, 0xff, 0xff, 0xff, 0xff, 0xff, 0xff, 0xff, 0xe0, 0xff, 0xf0, 0x7f, 0xff, 0xff, 0xff, 0xff },
	{ 0x1f, 0xff, 0xff, 0xff, 0xff, 0xff, 0xff, 0xff, 0xe0, 0xff, 0xf0, 0x7f, 0xff, 0xff, 0xff, 0xff },
	{ 0x0f, 0xff, 0xff, 0xff, 0xff, 0xff, 0xff, 0xff, 0xc0, 0xff, 0xf0, 0x7f, 0xff, 0xff, 0xff, 0xff },
	{ 0x07, 0xff, 0xff, 0xff, 0xff, 0xff, 0xff, 0xff, 0xc0, 0xff, 0xf0, 0x7f, 0xff, 0xff, 0xff, 0xff },
	{ 0x03, 0xff, 0xff, 0xff, 0xff, 0xff, 0xff, 0xff, 0xc1, 0xff, 0xe0, 0x7f, 0xff, 0xff, 0xff, 0xff },
	{ 0x01, 0xff, 0xff, 0xff, 0xff, 0xff, 0xff, 0xff, 0xc1, 0xff, 0xe0, 0xff, 0xff, 0xff, 0xff, 0xff },
	{ 0x00, 0xff, 0xff, 0xff, 0xff, 0xff, 0xff, 0xff, 0xc1, 0xff, 0xe0, 0xff, 0xff, 0xff, 0xff, 0xff },
	{ 0x00, 0x7f, 0xff, 0xff, 0xff, 0xff, 0xff, 0xff, 0x81, 0xff, 0xe0, 0xff, 0xff, 0xff, 0xff, 0xff },
	{ 0x00, 0x3f, 0xff, 0xff, 0xff, 0xff, 0xff, 0xff, 0x81, 0xff, 0xe0, 0xff, 0xff, 0xff, 0xff, 0xff },
	{ 0x00, 0x1f, 0xff, 0xff, 0xff, 0xff, 0xff, 0xff, 0x81, 0xff, 0xe0, 0xff, 0xff, 0xff, 0xff, 0xff },
	{ 0x00, 0x0f, 0xff, 0xff, 0xff, 0xff, 0xff, 0xff, 0x83, 0xff, 0xc1, 0xff, 0xff, 0xff, 0xff, 0xff },
	{ 0x00, 0x07, 0xff, 0xff, 0xff, 0xff, 0xff, 0xff, 0x83, 0xff, 0xc1, 0xff, 0xff, 0xff, 0xff, 0xff },
	{ 0x00, 0x03, 0xff, 0xff, 0xff, 0xff, 0xff, 0xff, 0x03, 0xff, 0xc1, 0xff, 0xff, 0xff, 0xff, 0xff },
	{ 0x00, 0x03, 0xff, 0xff, 0xff, 0xff, 0xff, 0xff, 0x03, 0xff, 0xc1, 0xff, 0xff, 0xff, 0xff, 0xff },
	{ 0x00, 0x01, 0xff, 0xff, 0xff, 0xff, 0xff, 0xff, 0x03, 0xff, 0xc1, 0xff, 0xff, 0xff, 0xff, 0xff },
	{ 0x00, 0x00, 0xff, 0xff, 0xff, 0xff, 0xff, 0xff, 0x07, 0xff, 0x81, 0xff, 0xff, 0xff, 0xff, 0xff },
	{ 0x00, 0x00, 0xff, 0xff, 0xff, 0xff, 0xff, 0xff, 0x07, 0xff, 0x83, 0xff, 0xff, 0xff, 0xff, 0xff },
	{ 0x00, 0x00, 0xff, 0xff, 0xff, 0xff, 0xff, 0xfe, 0x07, 0xff, 0x83, 0xff, 0xff, 0xff, 0xff, 0xff },
	{ 0x00, 0x00, 0x7f, 0xff, 0xff, 0xff, 0xff, 0xfe, 0x07, 0xff, 0x83, 0xff, 0xff, 0xff, 0xff, 0xff },
	{ 0x00, 0x00, 0x7f, 0xff, 0xff, 0xff, 0xff, 0xfe, 0x07, 0xff, 0x83, 0xff, 0xff, 0xff, 0xff, 0xff },
	{ 0x00, 0x00, 0x3f, 0xff, 0xff, 0xff, 0xff, 0xfe, 0x0f, 0xff, 0x01, 0xff, 0xff, 0xff, 0xff, 0xff },
	{ 0x00, 0x00, 0x3f, 0xff, 0xff, 0xff, 0xff, 0xfe, 0x00, 0x00, 0x00, 0x03, 0xff, 0xff, 0xff, 0xff },
	{ 0x00, 0x00, 0x3f, 0xff, 0xff, 0xff, 0xff, 0xfe, 0x00, 0x00, 0x00, 0x03, 0xff, 0xff, 0xff, 0xff },
	{ 0x00, 0x00, 0x1f, 0xff, 0xff, 0xff, 0xff, 0xfc, 0x00, 0x00, 0x00, 0x03, 0xff, 0xff, 0xff, 0xfe },
	{ 0x00, 0x00, 0x1f, 0xff, 0xff, 0xff, 0xff, 0xfc, 0x00, 0x00, 0x00, 0x03, 0xff, 0xff, 0xff, 0xf0 },
	{ 0x00, 0x00, 0x0f, 0xff, 0xff, 0x87, 0xff, 0xfc, 0x00, 0x00, 0x00, 0x07, 0xff, 0xff, 0xff, 0x80 },
	{ 0x00, 0x00, 0x0f, 0xff, 0xfc, 0x01, 0xff, 0xfc, 0x00, 0x00, 0x00, 0x07, 0xff, 0xff, 0xfc, 0x00 },
	{ 0x00, 0x00, 0x07, 0xff, 0xf8, 0x00, 0xff, 0xfc, 0x00, 0x00, 0x00, 0x07, 0xff, 0xff, 0xf0, 0x00 },
	{ 0x00, 0x00, 0x07, 0xff, 0xf0, 0x00, 0x7f, 0xfc, 0x00, 0x00, 0x00, 0x07, 0xff, 0xff, 0x80, 0x00 },
	{ 0x00, 0x00, 0x03, 0xff, 0xe0, 0x00, 0x3f, 0xfc, 0x00, 0x00, 0x00, 0x07, 0xff, 0xfe, 0x00, 0x00 },
	{ 0x00, 0x00, 0x01, 0xff, 0xc0, 0x00, 0x3f, 0xfc, 0x00, 0x00, 0x00, 0x07, 0xff, 0xfc, 0x00, 0x00 },
	{ 0x00, 0x00, 0x00, 0xff, 0x80, 0x00, 0x1f, 0xfc, 0x00, 0x00, 0x00, 0x0f, 0xff, 0xf0, 0x00, 0x00 },
	{ 0x00, 0x00, 0x00, 0x7f, 0x00, 0x00, 0x0f, 0xfc, 0x00, 0x00, 0x00, 0x0f, 0xff, 0xc0, 0x00, 0x00 },
	{ 0x00, 0x00, 0x00, 0x00, 0x00, 0x00, 0x0f, 0xfe, 0x00, 0x00, 0x00, 0x0f, 0xff, 0x80, 0x00, 0x00 },
	{ 0x00, 0x00, 0x00, 0x00, 0x00, 0x00, 0x07, 0xff, 0x00, 0x00, 0x00, 0x0f, 0xff, 0x00, 0x00, 0x00 },
	{ 0x00, 0x00, 0x00, 0x00, 0x00, 0x00, 0x07, 0xff, 0x80, 0x00, 0x00, 0x0f, 0xfc, 0x00, 0x00, 0x00 },
	{ 0x00, 0x00, 0x00, 0x00, 0x00, 0x00, 0x03, 0xff, 0xf0, 0x00, 0x00, 0x1f, 0xf8, 0x00, 0x00, 0x00 },
	{ 0x00, 0x00, 0x00, 0x00, 0x00, 0x00, 0x03, 0xff, 0xff, 0xff, 0xff, 0xff, 0xf0, 0x00, 0x00, 0x00 },
	{ 0x00, 0x00, 0x00, 0x00, 0x00, 0x00, 0x01, 0xff, 0xff, 0xff, 0xff, 0xff, 0xe0, 0x00, 0x00, 0x00 },
	{ 0x00, 0x00, 0x00, 0x00, 0x00, 0x00, 0x01, 0xff, 0xff, 0xff, 0xff, 0xff, 0xc0, 0x00, 0x00, 0x00 },
	{ 0x00, 0x00, 0x00, 0x00, 0x00, 0x00, 0x01, 0xff, 0xff, 0xff, 0xff, 0xff, 0x80, 0x00, 0x00, 0x00 },
	{ 0x00, 0x00, 0x00, 0x00, 0x00, 0x00, 0x00, 0xff, 0xff, 0xff, 0xff, 0xff, 0x80, 0x00, 0x00, 0x00 },
	{ 0x00, 0x00, 0x00, 0x00, 0x00, 0x00, 0x00, 0xff, 0xff, 0xff, 0xff, 0xff, 0x00, 0x00, 0x00, 0x00 },
	{ 0x00, 0x00, 0x00, 0x00, 0x00, 0x00, 0x00, 0x7f, 0xff, 0xff, 0xff, 0xfe, 0x00, 0x00, 0x00, 0x00 },
	{ 0x00, 0x00, 0x00, 0x00, 0x00, 0x00, 0x00, 0x7f, 0xff, 0xff, 0xff, 0xfc, 0x00, 0x00, 0x00, 0x00 },
	{ 0x00, 0x00, 0x00, 0x00, 0x00, 0x00, 0x00, 0x3f, 0xff, 0xff, 0xff, 0xfc, 0x00, 0x00, 0x00, 0x00 },
	{ 0x00, 0x00, 0x00, 0x00, 0x00, 0x00, 0x00, 0x3f, 0xff, 0xff, 0xff, 0xf8, 0x00, 0x00, 0x00, 0x00 },
	{ 0x00, 0x00, 0x00, 0x00, 0x00, 0x00, 0x00, 0x1f, 0xff, 0xff, 0xff, 0xf8, 0x00, 0x00, 0x00, 0x00 },
	{ 0x00, 0x00, 0x00, 0x00, 0x00, 0x00, 0x00, 0x1f, 0xff, 0xff, 0xff, 0xf0, 0x00, 0x00, 0x00, 0x00 },
	{ 0x00, 0x00, 0x00, 0x00, 0x00, 0x00, 0x00, 0x0f, 0xff, 0xff, 0xff, 0xf0, 0x00, 0x00, 0x00, 0x00 },
	{ 0x00, 0x00, 0x00, 0x00, 0x00, 0x00, 0x00, 0x0f, 0xff, 0xff, 0xff, 0xf0, 0x00, 0x00, 0x00, 0x00 },
	{ 0x00, 0x00, 0x00, 0x00, 0x00, 0x00, 0x00, 0x07, 0xff, 0xff, 0xff, 0xe0, 0x00, 0x00, 0x00, 0x00 },
	{ 0x00, 0x00, 0x00, 0x00, 0x00, 0x00, 0x00, 0x07, 0xff, 0xff, 0xff, 0xe0, 0x00, 0x00, 0x00, 0x00 },
	{ 0x00, 0x00, 0x00, 0x00, 0x00, 0x00, 0x00, 0x03, 0xff, 0xff, 0xff, 0xe0, 0x00, 0x00, 0x00, 0x00 },
	{ 0x00, 0x00, 0x00, 0x00, 0x00, 0x00, 0x00, 0x03, 0xff, 0xff, 0xff, 0xe0, 0x00, 0x00, 0x00, 0x00 },
	{ 0x00, 0x00, 0x00, 0x00, 0x00, 0x00, 0x00, 0x01, 0xff, 0xff, 0xff, 0xe0, 0x00, 0x00, 0x00, 0x00 },
	{ 0x00, 0x00, 0x00, 0x00, 0x00, 0x00, 0x00, 0x01, 0xff, 0xff, 0xff, 0xe0, 0x00, 0x00, 0x00, 0x00 },
	{ 0x00, 0x00, 0x00, 0x00, 0x00, 0x00, 0x00, 0x00, 0xff, 0xff, 0xff, 0xe0, 0x00, 0x00, 0x00, 0x00 },
	{ 0x00, 0x00, 0x00, 0x00, 0x00, 0x00, 0x00, 0x00, 0x7f, 0xff, 0xff, 0xe0, 0x00, 0x00, 0x00, 0x00 },
	{ 0x00, 0x00, 0x00, 0x00, 0x00, 0x00, 0x00, 0x00, 0x3f, 0xff, 0xff, 0xe0, 0x00, 0x00, 0x00, 0x00 },
	{ 0x00, 0x00, 0x00, 0x00, 0x00, 0x00, 0x00, 0x00, 0x3f, 0xff, 0xff, 0xe0, 0x00, 0x00, 0x00, 0x00 },
	{ 0x00, 0x00, 0x00, 0x00, 0x00, 0x00, 0x00, 0x00, 0x1f, 0xff, 0xff, 0xe0, 0x00, 0x00, 0x00, 0x00 },
	{ 0x00, 0x00, 0x00, 0x00, 0x00, 0x00, 0x00, 0x00, 0x0f, 0xff, 0xff, 0xe0, 0x00, 0x00, 0x00, 0x00 },
	{ 0x00, 0x00, 0x00, 0x00, 0x00, 0x00, 0x00, 0x00, 0x07, 0xff, 0xff, 0xe0, 0x00, 0x00, 0x00, 0x00 },
	{ 0x00, 0x00, 0x00, 0x00, 0x00, 0x00, 0x00, 0x00, 0x03, 0xff, 0xff, 0xf0, 0x00, 0x00, 0x00, 0x00 },
	{ 0x00, 0x00, 0x00, 0x00, 0x00, 0x00, 0x00, 0x00, 0x01, 0xff, 0xff, 0xf0, 0x00, 0x00, 0x00, 0x00 },
	{ 0x00, 0x00, 0x00, 0x00, 0x00, 0x00, 0x00, 0x00, 0x00, 0x7f, 0xff, 0xf0, 0x00, 0x00, 0x00, 0x00 },
	{ 0x00, 0x00, 0x00, 0x00, 0x00, 0x00, 0x00, 0x00, 0x00, 0x3f, 0xff, 0xf8, 0x00, 0x00, 0x00, 0x00 },
	{ 0x00, 0x00, 0x00, 0x00, 0x00, 0x00, 0x00, 0x00, 0x00, 0x0f, 0xff, 0xf8, 0x00, 0x00, 0x00, 0x00 },
	{ 0x00, 0x00, 0x00, 0x00, 0x00, 0x00, 0x00, 0x00, 0x00, 0x03, 0xff, 0xf0, 0x00, 0x00, 0x00, 0x00 },
	{ 0x00, 0x00, 0x00, 0x00, 0x00, 0x00, 0x00, 0x00, 0x00, 0x00, 0x3f, 0x80, 0x00, 0x00, 0x00, 0x00 },
};

static void sprite_init(void)
{
	for (int y = 0; y < SPRITE_H; y++) {
		for (int x = 0; x < SPRITE_W; x++) {
			bool is_red = ti_logo_bitmap[y][x / 8] & BIT(7 - (x % 8));

			g_sprite[y * SPRITE_W + x] = is_red ? COLOR_RED : COLOR_BG;
		}
	}
}

/*
 * Copy g_sprite into the framebuffer at origin (ox, oy).
 * Pixels that fall outside [0, fw) x [0, fh) are silently clipped.
 */
static void sprite_blit(uint32_t *fb, uint16_t fw, uint16_t fh, int ox, int oy)
{
	for (int sy = 0; sy < SPRITE_H; sy++) {
		int fy = oy + sy;

		if (fy < 0 || fy >= fh) {
			continue;
		}
		for (int sx = 0; sx < SPRITE_W; sx++) {
			int fx = ox + sx;

			if (fx < 0 || fx >= fw) {
				continue;
			}
			fb[(size_t)fy * fw + fx] = g_sprite[sy * SPRITE_W + sx];
		}
	}
}

int main(void)
{
	const struct device *disp = DEVICE_DT_GET(DT_CHOSEN(zephyr_display));
	struct display_capabilities caps;
	struct display_buffer_descriptor desc;
	uint32_t *fb[2];
	uint32_t cb_handle;
	int buf_idx = 0;
	int sprite_x = 0;
	int sprite_y = 0;
	int dir_x = 1;
	int y_target = 0;
	bool descending = false;
	int ret;

	if (!device_is_ready(disp)) {
		LOG_ERR("display not ready");
		return -ENODEV;
	}

	display_get_capabilities(disp, &caps);

	if (caps.current_pixel_format != PIXEL_FORMAT_ARGB_8888) {
		LOG_ERR("sample requires PIXEL_FORMAT_ARGB_8888, got %d",
			caps.current_pixel_format);
		return -ENOTSUP;
	}

	const size_t fb_bytes = (size_t)caps.x_resolution *
				caps.y_resolution * sizeof(uint32_t);
	const size_t fb_npix  = (size_t)caps.x_resolution * caps.y_resolution;

	/*
	 * Two buffers: while the DSS is scanning one, the CPU renders into the
	 * other.  64-byte alignment covers the Cortex-A53 cache line and any
	 * DSS DMA alignment requirement.
	 */
	fb[0] = k_aligned_alloc(64, fb_bytes);
	fb[1] = k_aligned_alloc(64, fb_bytes);
	if (!fb[0] || !fb[1]) {
		LOG_ERR("framebuffer alloc (%zu B x2) failed — increase "
			"CONFIG_HEAP_MEM_POOL_ADD_SIZE_SAMPLE", fb_bytes);
		ret = -ENOMEM;
		goto out_free;
	}

	sprite_init();

	desc.buf_size         = fb_bytes;
	desc.pitch            = caps.x_resolution;
	desc.width            = caps.x_resolution;
	desc.height           = caps.y_resolution;
	desc.frame_incomplete = false;

	ret = display_blanking_off(disp);
	if (ret < 0 && ret != -ENOSYS) {
		LOG_ERR("blanking_off failed: %d", ret);
		goto out_free;
	}
	ret = 0;

	/*
	 * Register vsync_cb for DISPLAY_EVENT_VSYNC, to be called from ISR
	 * context (in_isr = true).  tidss_isr() fires this callback after
	 * latching each new buffer into the DSS shadow registers.
	 */
	ret = display_register_event_cb(disp, vsync_cb, NULL,
					DISPLAY_EVENT_VSYNC, true, &cb_handle);
	if (ret < 0) {
		LOG_ERR("display_register_event_cb failed: %d", ret);
		goto out_free;
	}

	LOG_INF("%s %ux%u ARGB8888 — %ux%u sprite stride-sweep",
		disp->name, caps.x_resolution, caps.y_resolution,
		SPRITE_W, SPRITE_H);

	/* Render the first frame into fb[0] before entering the display loop. */
	for (size_t i = 0; i < fb_npix; i++) {
		fb[0][i] = COLOR_BG;
	}
	sprite_blit(fb[0], caps.x_resolution, caps.y_resolution, sprite_x, sprite_y);

	uint32_t fps_count     = 0;
	int64_t  fps_timestamp = k_uptime_get();

	for (;;) {
		/*
		 * Kick off the non-blocking display write for the current
		 * render buffer.  tidss_write() enqueues fb[buf_idx] into
		 * req_q and returns immediately.  The driver ISR dequeues it
		 * at the next VSYNC, latches it into the DSS shadow registers,
		 * and fires vsync_cb.
		 */
		ret = display_write(disp, 0, 0, &desc, fb[buf_idx]);
		if (ret < 0) {
			LOG_ERR("display_write failed: %d", ret);
			break;
		}

		/*
		 * Block until vsync_cb fires from ISR context and gives this
		 * semaphore.  fb[buf_idx] is now the active DSS scanout buffer
		 * and must not be written until the next swap.
		 */
		k_sem_take(&vsync_sem, K_FOREVER);

		/* FPS: count confirmed VSYNC callbacks; report once per second. */
		fps_count++;
		int64_t now     = k_uptime_get();
		int64_t elapsed = now - fps_timestamp;

		if (elapsed >= 1000) {
			LOG_INF("FPS: %u", (uint32_t)(fps_count * 1000U / elapsed));
			fps_count     = 0;
			fps_timestamp = now;
		}

		/*
		 * Swap to the other buffer.  fb[buf_idx ^ 1] was the previous
		 * scanout and is no longer being read by the hardware, so it
		 * is safe to render into it.
		 */
		buf_idx ^= 1;

		/*
		 * Advance the sprite position and render the next frame.
		 * Each row is swept in the opposite direction of the row
		 * before it (boustrophedon).  Once an edge is reached, the
		 * sprite descends to the next row in STEP_PX increments
		 * rather than jumping the full SPRITE_H in one frame, then
		 * resumes the horizontal sweep in the reversed direction.
		 */
		if (descending) {
			sprite_y += STEP_PX;
			if (sprite_y >= y_target) {
				sprite_y = y_target;
				descending = false;
			}
		} else {
			sprite_x += dir_x * STEP_PX;
			if (dir_x > 0 && sprite_x + SPRITE_W > caps.x_resolution) {
				sprite_x = caps.x_resolution - SPRITE_W;
				dir_x = -1;
				y_target = sprite_y + SPRITE_H;
				if (y_target >= caps.y_resolution) {
					sprite_y = 0;
				} else {
					descending = true;
				}
			} else if (dir_x < 0 && sprite_x < 0) {
				sprite_x = 0;
				dir_x = 1;
				y_target = sprite_y + SPRITE_H;
				if (y_target >= caps.y_resolution) {
					sprite_y = 0;
				} else {
					descending = true;
				}
			}
		}

		for (size_t i = 0; i < fb_npix; i++) {
			fb[buf_idx][i] = COLOR_BG;
		}
		sprite_blit(fb[buf_idx], caps.x_resolution, caps.y_resolution,
			    sprite_x, sprite_y);
	}

	display_unregister_event_cb(disp, cb_handle);

out_free:
	k_free(fb[0]);
	k_free(fb[1]);
	return ret;
}
```
